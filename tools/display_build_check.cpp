// ===========================================================================
//  display_build_check — ЧИ ЗБИРАЄТЬСЯ ДРАЙВЕР ЕКРАНА ВЗАГАЛІ
// ===========================================================================
//  Доти драйвер екрана був ЄДИНИМ великим файлом проєкту без жодної збірки на
//  хості: усі перевірки для нього — текстові («чи є в файлі такий виклик»), а
//  текст не бачить ні описки в імені, ні зайвої дужки, ні звернення до поля,
//  якого немає. Знаходилось це вже в Arduino IDE — тобто після того, як
//  прошивку залили в прилад. Один раз саме так і вийшло: власник побачив
//  чорний екран і день пішов на розбір, чи винна правка.
//
//  ⚑ ЩО САМЕ ПЕРЕВІРЯЄТЬСЯ. Складання ST7789 — те, що стоїть у власника
//  (settings.h). Монохромний шлях (u8g2) сюди НЕ входить: у нього десяток
//  класів на кожну модель екрана, і заглушки до них коштували б більше, ніж
//  дають. Це чесно сказано й у виводі — щоб «зелено» не читалось як «усе
//  покрито».
//
//  Малюють заглушки в нікуди (tools/fake/): картинку перевірити на хості
//  однаково неможливо, а от синтаксис і імена — цілком.
// ===========================================================================
#include <cstdio>
#include <cstring>

// Версія ядра — та сама, що в власника (лог компілятора): buzzer.h без неї
// не проходить власну перевірку на нову timer-API.
#define ESP_ARDUINO_VERSION_VAL(a, b, c) (((a) << 16) | ((b) << 8) | (c))
#define ESP_ARDUINO_VERSION ESP_ARDUINO_VERSION_VAL(3, 3, 11)
#define ESP_ARDUINO_VERSION_MAJOR 3

#include "esp32_stubs.h"
#include "display.h"

// Глобали, які в прошивці визначає сам скетч (.ino). Драйвер їх читає, тож
// без них збірка доходить лише до компонувальника — а нам треба перевірити
// саме зібраний файл, а не «майже зібраний».
uint8_t batteryDump[DUMP_SIZE];        bool hasDump     = false;
uint8_t batteryDump2438[DS2438_MEM_SIZE]; bool hasDump2438 = false;
uint8_t chipSN2433[8] = {0};           bool hasSN2433   = false;
uint8_t chipSN2438[8] = {0};           bool hasSN2438   = false;

// ===========================================================================
//  2) ЩО РОБЛЯТЬ КНОПКИ — НАСПРАВДІ, А НЕ ЗА ТЕКСТОМ ФАЙЛА
// ===========================================================================
//  ⚑ ЧОМУ ЦЕ ТУТ, А НЕ ТЕКСТОВОЮ ПЕРЕВІРКОЮ В session_guard. Правило власника
//  просте: «коротке — зчитування, довге — меню». Перевірити його грепом можна
//  лише як «у файлі є такий рядок» — а це стереже НАПИС, а не поведінку: рядок
//  міг би стояти в гілці, куди не доходить виконання, або після нього могла б
//  іти друга гілка, яка все переграє. Драйвер збирається на хості, кнопки
//  висять на керованому ADC — отже можна натиснути по-справжньому й подивитись,
//  що вийшло.
static int fails2 = 0;
static void ck(bool ok, const char *m) {
    printf(ok ? "   ок    %s\n" : "   ЗБІЙ  %s\n", m);
    if (!ok) fails2++;
}

// Напруга на дільнику, яку дає кожна кнопка (див. settings.h: MENU_BTN_ADC_*).
static const int ADC_NONE  = 4095;
static const int ADC_ENTER = 0;
static const int ADC_LEFT  = (MENU_BTN_ADC_MV_LEFT)  * 4095 / 3300;
static const int ADC_RIGHT = (MENU_BTN_ADC_MV_RIGHT) * 4095 / 3300;

// Один прохід loop(): подати стан кнопок і дати драйверові його побачити.
static void step(int adc, unsigned long ms) {
    g_fakeAdc = adc;
    g_fakeMillis += ms;
    displayHandleButton();
}
// Натиснути й відпустити.
//
//  ⚑ ТРИМАННЯ ОПИТУЄТЬСЯ БАГАТО РАЗІВ, А НЕ ДВІЧІ, і це не педантизм. Перша
//  редакція цього помічника подавала «натиснуто» рівно двома проходами —
//  і довге натискання не спрацьовувало ВЗАГАЛІ: антидребезг визнає кнопку
//  натиснутою лише на другому проході, тобто відлік утримання починався в мить
//  відпускання. У приладі loop() крутиться безперервно; помічник, який цього не
//  відтворює, перевіряє не прошивку, а сам себе.
static void tap(int adc, unsigned long holdMs) {
    step(adc, 30);                                   // натиснули
    for (unsigned long t = 0; t < holdMs; t += 20) step(adc, 20);
    step(ADC_NONE, 30); step(ADC_NONE, 30);          // відпустили
}

static void buttonsBehave() {
    printf("\n2) кнопки: коротке — зчитування, довге — меню\n");

    g_fakeMillis = 100000;
    g_displayPage = 0;                       // кільце показань
    (void)displayConsumeReadRequest();

    // ── КОРОТКЕ «OK» НА ПОКАЗАННЯХ = ЗЧИТУВАННЯ ──────────────────────────
    tap(ADC_ENTER, 200);
    ck(displayConsumeReadRequest(), "коротке «OK» просить зчитування");
    ck(g_displayPage == 0, "…і сторінку не міняє: меню не відкривається саме");

    // ── ДОВГЕ «OK» = МЕНЮ ────────────────────────────────────────────────
    //  ⚑ ДОВГЕ НА ЦІЙ КНОПЦІ ВИРІШУЄТЬСЯ НА ВІДПУСКАННІ (сходи жестів), тож
    //  тримаємо довше за COMBO_LONG_MS і відпускаємо ДО порога заряду.
    tap(ADC_ENTER, COMBO_LONG_MS + 300);
    ck(g_displayPage == PAGE_MENU, "довге «OK» відкриває меню");
    ck(!displayConsumeReadRequest(), "…і зчитування дорогою не просить");

    // ── ПІДКАЗКА КАЖЕ ТЕ САМЕ, ЩО Й РОБИТЬ КНОПКА ────────────────────────
    //  ⚑ ПІДКАЗКА, ЯКА БРЕШЕ, ГІРША ЗА ВІДСУТНЮ. Людина тримає кнопку, читає
    //  «відпустіть = ЗЧИТАТИ», відпускає — відкривається меню. Наступного разу
    //  вона не вірить жодній підказці приладу.
    g_displayPage = 0;
    {
        const char *h = holdLongHint();
        ck(h && strstr(h, "МЕНЮ") != nullptr, "підказка довгого обіцяє МЕНЮ");
        ck(!h || strstr(h, "ЗЧИТ") == nullptr, "…і не обіцяє зчитування");
    }

    // ── І НАВПАКИ: З МЕНЮ ЗЧИТУВАННЯ НЕ ПРОСИТЬСЯ ────────────────────────
    //  Коротке «OK» у меню — це вибір пункту, а не читання пакета.
    g_displayPage = PAGE_MENU;
    tap(ADC_ENTER, 200);
    ck(!displayConsumeReadRequest(), "у меню коротке «OK» пакета не читає");

    // ── ПРИХОВАНИЙ ЖЕСТ ──────────────────────────────────────────────────
    //  Набираємо його клавішами так само, як це робить людина, і дивимось на
    //  повноекранний напис. Що саме там написано — тест не питає; питає лише,
    //  чи з'явився він тоді, коли треба, і чи не з'являється, коли не треба.
    g_displayPage = 0;
    g_flash.until = 0;
    comboSeqReset(g_seq);
    (void)displayConsumeReadRequest();

    //  «‹ ‹ › › › › ‹ ‹ ›» — дев'ять клавіш, і жодного «OK» серед них.
    const int SEQ[] = { ADC_LEFT, ADC_LEFT, ADC_RIGHT, ADC_RIGHT, ADC_RIGHT,
                        ADC_RIGHT, ADC_LEFT, ADC_LEFT, ADC_RIGHT };
    const int SEQN = (int)(sizeof(SEQ) / sizeof(SEQ[0]));
    int pageBefore = g_displayPage;
    bool early = false;
    for (int i = 0; i < SEQN - 1; i++) {
        tap(SEQ[i], 150);
        if (displayFlashActive()) early = true;
    }
    ck(!early, "перші вісім клавіш напису не дають");
    pageBefore = g_displayPage;
    tap(SEQ[SEQN - 1], 150);
    ck(displayFlashActive(), "набраний ланцюжок показує повноекранний напис");
    //  ⚑ І ОСТАННЯ КЛАВІША НЕ СПРАЦЮВАЛА ЩЕ Й ЯК ЗВИЧАЙНА. Інакше разом із
    //  жестом сторінка поїхала б далі — напис на екрані, а під ним уже інша.
    ck(g_displayPage == pageBefore, "…і сторінку нею не перегорнуло");
    ck(!displayConsumeReadRequest(), "…і зчитування нею не запустилось");

    // Будь-яке натискання прибирає напис.
    tap(ADC_RIGHT, 150);
    ck(!displayFlashActive(), "наступне натискання прибирає напис");

    // ── ЖЕСТ НЕ НАБИРАЄТЬСЯ ЗВИЧАЙНИМ ГОРТАННЯМ ──────────────────────────
    g_displayPage = 0; g_flash.until = 0; comboSeqReset(g_seq);
    bool fired = false;
    for (int i = 0; i < 60; i++) {
        tap((i % 2) ? ADC_RIGHT : ADC_LEFT, 150);
        if (displayFlashActive()) fired = true;
    }
    ck(!fired, "шістдесят разів «вперед-назад» напису не викликають");
    g_flash.until = 0; comboSeqReset(g_seq);
    for (int i = 0; i < 60; i++) {               // довгий пробіг в один бік
        tap(ADC_RIGHT, 150);
        if (displayFlashActive()) fired = true;
    }
    ck(!fired, "…і довге гортання в один бік теж");

    // ── ВІКНО: НЕДОБРАНИЙ ЖЕСТ НЕ ЧЕКАЄ ВІЧНО ────────────────────────────
    g_displayPage = 0; g_flash.until = 0; comboSeqReset(g_seq);
    for (int i = 0; i < SEQN - 1; i++) tap(SEQ[i], 150);
    g_fakeMillis += COMBO_SEQ_WINDOW_MS + 1000;
    displayHandleButton();                       // прохід без натискання
    tap(SEQ[SEQN - 1], 150);
    ck(!displayFlashActive(), "після 5 секунд ланцюжок обнулено — добрати його нічим");
}

int main() {
    printf("1) драйвер екрана ST7789 збирається на хості\n");
    printf("   складання: %dx%d, поворот %d\n",
           (int)PANEL_W, (int)PANEL_H, (int)DISPLAY_ST7789_ROT);

    // ⚑ ФУНКЦІЇ ТРЕБА ЩЕ Й КЛИКНУТИ. inline-функція, яку ніхто не викликає,
    //  у C++ не інстанціюється повністю — тобто тіло могло б лишитись
    //  неперевіреним, і перевірка «зібралось» нічого б не значила.
    (void)displayFlashActive();
    (void)holdLongHint();
    (void)displayConsumeReadRequest();
    (void)displayConsumeActionRequest();
    displayHandleButton();
    displaySetStatus("тест");

    printf("   узято в роботу: displayHandleButton, holdLongHint, "
           "displayFlashActive, displaySetStatus\n");
    printf("   ⚠ монохромний шлях (u8g2) сюди НЕ входить — див. коментар у файлі\n");

    buttonsBehave();

    printf("\n%s (помилок: %d)\n",
           fails2 ? "Є ПОМИЛКИ" : "усі перевірки пройдено", fails2);
    return fails2 ? 1 : 0;
}
