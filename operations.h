#ifndef OPERATIONS_H
#define OPERATIONS_H
// ===========================================================================
//  operations.h — ЄДИНИЙ КАТАЛОГ ОПЕРАЦІЙ для всіх поверхонь.
//
//  Раніше список дій дублювався у чотирьох місцях (екранне меню в display.h і
//  display_color.h, веб index.html, USB-клієнт client_usb.html + moto_gui.py) і
//  розходився: назви, порядок, попередження й навіть склад операцій відрізнялися.
//  Тепер список описано ТУТ, а поверхні його лише малюють:
//    • екранне меню бере назви/описи прямо з opInfo();
//    • веб і USB-клієнти отримують той самий каталог у JSON (/api/ops, OPS).
//
//  ПОРЯДОК — за реальним ходом ремонту, а не «як склалось історично»:
//
//    1. Заміна елементів     ← головна операція, тому перша
//    2. Глибока чистка
//    3. Ремонт цілісності
//    4. Заряд із напруги
//    5. Скидання лічильників
//    6. Очистка історії
//    6a. Розряд перед калібруванням (навантаженням)
//    7. Модель <X>           ← модельна частина еталона (по одній на шаблон)
//    8. Новий <X>            ← ініціалізація порожнього чипа
//    9. Стерти DS2433 / DS2438 / Перезавантаження   ← крайні випадки
//
//  Чому саме так — див. docs/FIRMWARE_ANALYSIS.md. Коротко: після заміни
//  елементів рація відкидає не «зіпсовану», а ЧУЖУ навчену калібровку, тож
//  ремонт — це СКИДАННЯ блока 0x18A..0x1FF у «чистий» вигляд (скелет записів
//  лишається, навчені значення обнуляються), а не запис чужого еталона й не
//  стирання в 0xFF: на стертому хвості ЗП не може завершити калібрування.
//  Тому «Заміна елементів» стоїть першою, а побайтове копіювання еталона
//  прибрано з екранного меню (лишилось у ручному режимі: RESTORE … VERBATIM).
// ===========================================================================

#include "settings.h"        // BATTERY_SCALE_TXT* — шкала «заряд за напругою»
#include "radio_mode.h"      // RADIO_* — режим радіо як пункт каталогу
#include "templates.h"       // BATTERY_TEMPLATES / BATTERY_TEMPLATE_COUNT

// ---- рівень небезпеки ------------------------------------------------------
enum {
    OPD_SAFE   = 0,   // не змінює дані в чіпі
    OPD_WRITE  = 1,   // змінює дані, але зберігає ідентичність
    OPD_WIPE   = 2,   // незворотньо стирає ідентичність
};

// ---- У ЯКУ МІКРОСХЕМУ ЙДЕ ЗАПИС -------------------------------------------
//  У пакеті два різних чипа, і плутати їх дорого: DS2433 — це прошивка й
//  ідентичність (модель, крива, навчена калібровка), DS2438 — монітор
//  (лічильники, паливомір, заводське калібрування АЦП і шунт). Помилитись
//  чипом означає або втратити ідентичність, або збити вимірювання струму.
//  Тому кожна операція прямо каже, куди вона пише.
enum {
    OPC_NONE = 0,     // нічого не пише (діагностика, перезавантаження)
    OPC_33   = 1,     // лише DS2433
    OPC_38   = 2,     // лише DS2438
    OPC_BOTH = 3,     // обидві
};
inline const char *opChipsText(uint8_t c) {
    switch (c) {
        case OPC_33:   return "DS2433";
        case OPC_38:   return "DS2438";
        case OPC_BOTH: return "DS2433 + DS2438";
        default:       return "нічого не пише";
    }
}
// Коротко для вузького екрана пристрою.
inline const char *opChipsShort(uint8_t c) {
    switch (c) {
        case OPC_33:   return "2433";
        case OPC_38:   return "2438";
        case OPC_BOTH: return "2433+2438";
        default:       return "-";
    }
}

// ---- стабільні коди базових операцій --------------------------------------
// Значення НЕ змінювати: вони їдуть у JSON і в команди USB-клієнта.
enum {
    OP_CELLSWAP      = 0,   // ремонт після заміни елементів
    OP_CELLSWAP_DEEP = 1,   // те саме + навчені записи ємності й журнал
    OP_REPAIR        = 2,   // ремонт цілісності (суми + дзеркало)
    OP_SETCHARGE     = 3,   // паливомір за напругою (НЕ керований заряд! див. OP_CHARGE_DCDC)
    OP_RESET         = 4,   // обнулити лічильники
    OP_CLEAN         = 5,   // очистка історії
    OP_DISCHARGE     = 6,   // керований розряд навантаженням перед калібруванням
    OP_DISCHARGE_TGT = 7,   // вибір цільової напруги розряду (перемикач)
    OP_CHARGE_DCDC   = 8,   // керований заряд ШІМом на ключ (не плутати з OP_SETCHARGE!)
    OP_CHARGE_TGT    = 9,   // вибір цільового відсотка заряду (перемикач)
    OP_CHARGE_WAKE   = 10,  // примусове пробудження пакета, що не читається
    // ── ручні уставки й профілі (додані пізніше; коди 0..10 не рухаються) ──
    OP_CHARGE_PROFILE   = 11,  // заводська таблиця <-> розумний CC/CV
    OP_CHARGE_MANUAL_MA = 12,  // ручний струм заряду (0 = автомат)
    OP_CHARGE_MANUAL_MV = 13,  // ручна ціль заряду у вольтах (0 = за відсотком)
    OP_DIS_PROFILE      = 14,  // заводська лінійка <-> розумний 0.2C
    OP_DIS_MANUAL_MA    = 15,  // ручний струм розряду (0 = автомат)
    // ── зв'язок із клієнтами (додано пізніше; коди 0..15 не рухаються) ──
    OP_RADIO            = 16,  // Wi-Fi <-> Bluetooth (перемикач, діє з рестарту)
    OP_BASE_COUNT    = 17,
};

// Цілі розряду/заряду живуть у discharge.h/charge.h, які підключаються ПІСЛЯ
// цього файла. Оголошуємо наперед: тіло знайдеться в тій самій одиниці
// трансляції.
inline bool     chargeAvailable();
inline uint16_t dischargeTargetMv();
inline uint8_t  chargeTargetPct();
inline uint8_t  chargeProfile();
inline uint16_t chargeManualMa();
inline uint16_t chargeManualMv();
inline uint8_t  dischargeProfile();
inline uint16_t dischargeManualMa();

// Далі — по одній дії на шаблон:
//   [OP_BASE_COUNT               .. +COUNT-1] «Модель <X>»  (модельна частина)
//   [OP_BASE_COUNT + COUNT       .. +COUNT-1] «Новий <X>»   (порожній чіп -> АКБ)
// Потім три крайні операції.
inline int opModelBase()  { return OP_BASE_COUNT; }
inline int opNewBase()    { return OP_BASE_COUNT + BATTERY_TEMPLATE_COUNT; }
inline int opExpertBase() { return OP_BASE_COUNT + 2 * BATTERY_TEMPLATE_COUNT; }

enum { OP_WIPE33_REL = 0, OP_WIPE38_REL = 1, OP_REBOOT_REL = 2, OP_EXPERT_COUNT = 3 };

inline int opCount() { return opExpertBase() + OP_EXPERT_COUNT; }

// ---- розбір індексу --------------------------------------------------------
// Повертає індекс шаблону (0..COUNT-1) або -1.
inline int opTemplateOfModel(int sel) {
    int r = sel - opModelBase();
    return (r >= 0 && r < BATTERY_TEMPLATE_COUNT) ? r : -1;
}
inline int opTemplateOfNew(int sel) {
    int r = sel - opNewBase();
    return (r >= 0 && r < BATTERY_TEMPLATE_COUNT) ? r : -1;
}
// Повертає OP_WIPE33_REL/OP_WIPE38_REL/OP_REBOOT_REL або -1.
inline int opExpert(int sel) {
    int r = sel - opExpertBase();
    return (r >= 0 && r < OP_EXPERT_COUNT) ? r : -1;
}

// ---- описи для ЕКРАННОГО меню (коротко: 1 назва + 2 рядки) -----------------
struct OpText { const char *name, *l1, *l2; uint8_t danger, chips; };

static const OpText OP_TEXT[OP_BASE_COUNT] = {
    { "Заміна елем.",   "чистий хвіст 18A-",  "1FF: скелет+нулі",   OPD_WRITE, OPC_BOTH },
    { "Глибока чистка", "+ навчену ємність",  "і журнал використ.", OPD_WRITE, OPC_BOTH },
    { "Ремонт цілісн.", "контрольні суми",    "і дзеркало 2438",    OPD_WRITE, OPC_BOTH },
    { "Заряд з напруги","паливомір за U:",    BATTERY_SCALE_TXT_SHORT, OPD_WRITE, OPC_38   },
    { "Скид. лічильн.", "обнулити ETM,",      "CCA/DCA у DS2438",   OPD_WRITE, OPC_38   },
    { "Очистка історії","лічильники; модель", "і калібр. лишити",   OPD_WRITE, OPC_BOTH },
    { "Розряд",         "до заданої U, ШІМ",  "1000->300 мА",       OPD_WRITE, OPC_38   },
    { "Ціль розряду",   "натисніть, щоб",     "змінити напругу",    OPD_SAFE,  OPC_NONE },
    { "Заряд ШІМ",      "керований заряд",    "до обраного %",      OPD_WRITE, OPC_38   },
    { "Ціль заряду",    "натисніть, щоб",     "змінити відсоток",   OPD_SAFE,  OPC_NONE },
    // Пробудження нічого не пише в пам'ять і ні на що не спирається в ній —
    // воно взагалі для випадку, коли пам'яті не видно. Тому OPC_NONE (жодного
    // чипа) і OPD_WRITE (діє на залізо, тобто вимагає підтвердження).
    { "Пробудження",    "форс. старт заряду", "якщо АКБ не чит.",   OPD_WRITE, OPC_NONE },
    // Профілі й ручні уставки нічого не пишуть у чипи — це налаштування
    // самого пристрою, тому OPD_SAFE і OPC_NONE: вони вмикаються КОРОТКИМ
    // натисканням, без утримання (див. menuActivate у display.h).
    { "Профіль",        "заряд: як рахувати", "струм і кінець",     OPD_SAFE,  OPC_NONE },
    { "Струм",          "ручний струм",       "заряду (0=авто)",    OPD_SAFE,  OPC_NONE },
    { "Напруга",        "ручна ціль заряду",  "у вольтах",          OPD_SAFE,  OPC_NONE },
    { "Профіль",        "розряд: як рахувати","струм",              OPD_SAFE,  OPC_NONE },
    { "Струм",          "ручний струм",       "розряду (0=авто)",   OPD_SAFE,  OPC_NONE },
    // ⚑ OPD_SAFE, хоч воно й перезавантажує прилад. Рівень небезпеки тут
    //  відповідає на питання «що станеться з ПАКЕТОМ», а не «наскільки це
    //  помітно»: у пам'ять пакета цей пункт не пише жодного байта, тож вимагати
    //  утримання «ПУСК», як для стирання чипа, означало б зрівняти перемикач
    //  радіо зі знищенням даних. Перезавантаження (OP_REBOOT_REL) позначене так
    //  само й з тієї ж причини.
    { "Зв'язок",        "Wi-Fi або Bluetooth","(потрібен рестарт)",  OPD_SAFE,  OPC_NONE },
};

static const OpText OP_TEXT_EXPERT[OP_EXPERT_COUNT] = {
    { "СТЕРТИ 2433",   "ПОВНЕ стирання",  "чіпа (крайній!)",  OPD_WIPE, OPC_33   },
    { "СТЕРТИ 2438",   "ПОВНЕ стирання",  "монітора (крайн.)", OPD_WIPE, OPC_38  },
    { "Перезавантаж.", "рестарт пристрою","ESP32 (Wi-Fi/веб)", OPD_SAFE, OPC_NONE },
};

// Заповнює name/l1/l2/danger для пункту меню sel. buf — тимчасовий буфер під
// назви з моделлю («Модель PMNN4409B»), потрібен ≥26 байт.
inline void opInfo(int sel, const char **name, const char **l1, const char **l2,
                   uint8_t *danger, char *buf, size_t bufN, uint8_t *chips = nullptr) {
    uint8_t c = OPC_NONE;
    if (sel >= 0 && sel < OP_BASE_COUNT) {
        *name = OP_TEXT[sel].name; *l1 = OP_TEXT[sel].l1;
        *l2 = OP_TEXT[sel].l2;     *danger = OP_TEXT[sel].danger;
        c = OP_TEXT[sel].chips;
        // Обидва пункти розряду й обидва пункти заряду показують ОБРАНУ ціль
        // прямо в назві: інакше на пристрої не видно, до чого піде процес.
        if (sel == OP_DISCHARGE) {
            snprintf(buf, bufN, "Розряд %.2f В", dischargeTargetMv() / 1000.0);
            *name = buf;
        } else if (sel == OP_DISCHARGE_TGT) {
            snprintf(buf, bufN, "Ціль %.2f В", dischargeTargetMv() / 1000.0);
            *name = buf;
        } else if (sel == OP_CHARGE_DCDC) {
            snprintf(buf, bufN, "Заряд ШІМ %u%%", chargeTargetPct());
            *name = buf;
        } else if (sel == OP_CHARGE_TGT) {
            snprintf(buf, bufN, "Ціль заряду %u%%", chargeTargetPct());
            *name = buf;
        } else if (sel == OP_CHARGE_PROFILE) {
            // Значення — В НАЗВІ, як і в цілей: інакше поточний профіль видно
            // лише навівшись на пункт, а він міняє ВЕСЬ хід заряду.
            snprintf(buf, bufN, "Профіль %s",
                     chargeProfile() ? "CC/CV" : "таблиця");
            *name = buf;
        } else if (sel == OP_CHARGE_MANUAL_MA) {
            if (chargeManualMa()) snprintf(buf, bufN, "Струм %u мА", chargeManualMa());
            else                  snprintf(buf, bufN, "Струм авто");
            *name = buf;
        } else if (sel == OP_CHARGE_MANUAL_MV) {
            if (chargeManualMv())
                snprintf(buf, bufN, "Напруга %.2f В", chargeManualMv() / 1000.0);
            else
                snprintf(buf, bufN, "Напруга авто");
            *name = buf;
        } else if (sel == OP_DIS_PROFILE) {
            snprintf(buf, bufN, "Профіль %s",
                     dischargeProfile() ? "0.2C" : "лінійка");
            *name = buf;
        } else if (sel == OP_RADIO) {
            // Значення — В НАЗВІ, як у цілей і профілів: цей пункт вирішує, чи
            // буде зв'язок узагалі, і питати про поточний стан у самого пункту
            // означало б заходити в нього наосліп.
            snprintf(buf, bufN, "Зв'язок: %s", radioModeName(radioMode()));
            *name = buf;
        } else if (sel == OP_DIS_MANUAL_MA) {
            if (dischargeManualMa()) snprintf(buf, bufN, "Струм %u мА", dischargeManualMa());
            else                     snprintf(buf, bufN, "Струм авто");
            *name = buf;
        }
        if (chips) *chips = c;
        return;
    }
    int t = opTemplateOfModel(sel);
    if (t >= 0) {
        snprintf(buf, bufN, "Модель %s", BATTERY_TEMPLATES[t].name);
        *name = buf; *l1 = "записати модельну"; *l2 = "частину еталона";
        *danger = OPD_WRITE;
        // Для моделей без еталона монітора пишеться лише DS2433 — монітор
        // пакета лишається недоторканим разом із його заводським шунтом.
        if (chips) *chips = BATTERY_TEMPLATES[t].d38 ? OPC_BOTH : OPC_33;
        return;
    }
    t = opTemplateOfNew(sel);
    if (t >= 0) {
        snprintf(buf, bufN, "Новий %s", BATTERY_TEMPLATES[t].name);
        *name = buf; *l1 = "порожній чіп ->"; *l2 = "робочий АКБ моделі";
        *danger = OPD_WIPE;
        if (chips) *chips = OPC_BOTH;
        return;
    }
    int e = opExpert(sel);
    if (e >= 0) {
        *name = OP_TEXT_EXPERT[e].name; *l1 = OP_TEXT_EXPERT[e].l1;
        *l2 = OP_TEXT_EXPERT[e].l2;     *danger = OP_TEXT_EXPERT[e].danger;
        if (chips) *chips = OP_TEXT_EXPERT[e].chips;
        return;
    }
    *name = "—"; *l1 = ""; *l2 = ""; *danger = OPD_SAFE;
    if (chips) *chips = OPC_NONE;
}

// ===========================================================================
//  ПОРЯДОК ПУНКТІВ У МЕНЮ ПРИСТРОЮ — окремо від кодів операцій
// ===========================================================================
//  ЧОМУ ОКРЕМО. Коди OP_* перенумеровувати НЕ МОЖНА: вони їдуть у /api/ops, у
//  команди USB-клієнта й у збережені сценарії. Але порядок, у якому їх зручно
//  гортати на пристрої, — зовсім інше питання, ніж порядок, у якому їх колись
//  додавали. Тому показ описано ТУТ, окремою таблицею, і міняти його можна
//  вільно, нічого не ламаючи назовні.
//
//  ЩО БУЛО НЕ ТАК. На екрані всі дії лежали ОДНИМ ПЛОСКИМ КІЛЬЦЕМ, яке
//  гортається лише вперед: щоб дійти до «Перезавантаження» (останній пункт),
//  треба було натиснути OK стільки разів, скільки в пристрої операцій — а їх
//  17 + два на кожен шаблон. Повернутись на пункт назад було неможливо
//  взагалі: тільки по колу. І поруч, в одному кільці, лежали щоденний «Заряд»
//  і незворотнє «СТЕРТИ 2433».
//
//  ЯК ЗАРАЗ. Пункти зібрані в ГРУПИ за призначенням, групи йдуть за ходом
//  ремонту, а найнебезпечніше — в самому кінці, окремою групою:
//
//    (без групи)    ‹ Показання — вихід із меню
//    РЕМОНТ         заміна елементів -> глибока чистка -> ремонт цілісності
//    ЗАРЯД          заряд -> ціль % -> напруга -> струм -> профіль -> пробудження
//    РОЗРЯД         розряд -> ціль В -> струм -> профіль
//    ЛІЧИЛЬНИКИ     паливомір за напругою, скидання, очистка історії
//    МОДЕЛЬ         «Модель <X>» — по одному на шаблон
//    НОВИЙ ЧІП      «Новий <X>»  — по одному на шаблон
//    ДАНІ           сирі дампи DS2438 / DS2433
//    СИСТЕМА        Майстер відновлення, перезавантаження
//    НЕБЕЗПЕЧНО     СТЕРТИ 2433 / СТЕРТИ 2438
//
//  Перемикач цілі стоїть ОДРАЗУ ПІСЛЯ своєї дії, а не десь в іншому кінці
//  списку: це одна пара «що зробити» + «до чого», і шукати другу половину
//  через півсписку — саме те, на що скаржаться.
//
//  «Модель» і «Новий» розведені в РІЗНІ групи навмисно, хоч і йдуть по одному
//  на той самий шаблон: перша дописує модельну частину поверх живого пакета,
//  друга робить із чистого чипа новий АКБ і стирає ідентичність (OPD_WIPE).
//  В одній групі вони відрізнялись би лише першим словом назви.
//
//  У меню є й пункти, які нічого не виконують, а ВІДКРИВАЮТЬ СТОРІНКУ (дампи,
//  Майстер, вихід до показань). Так у пристрою лишається одне місце, де
//  зібрано все, що він уміє, замість «частина в кільці сторінок, частина в
//  кільці дій».
//
//  ⚑ ГРУПИ — ЦЕ Й Є ШВИДКА НАВІГАЦІЯ. Пунктів разом із шаблонами — під
//  чотири десятки, і гортати їх по одному було б не краще за старе кільце.
//  Тому довге натискання «‹»/«›» перестрибує на СУСІДНЮ ГРУПУ: до будь-якого
//  місця списку — не більше за кількість груп плюс довжина найдовшої з них.
//  Саме тому «ЕТАЛОНИ» й розбито надвоє: разом вони давали б групу на 18
//  пунктів, і стрибок по групах у ній нічого б не пришвидшив.
// ---------------------------------------------------------------------------

// Групи (порядок = порядок показу). MG_NAV — службова, без заголовка.
enum { MG_NAV = 0, MG_LINK, MG_REPAIR, MG_CHARGE, MG_DISCHARGE, MG_COUNTERS,
       MG_MODEL, MG_NEW, MG_DATA, MG_SYSTEM, MG_DANGER, MG_COUNT };

// Порожня назва означає «заголовок не малювати».
inline const char *menuGroupName(int g) {
    switch (g) {
        case MG_NAV:      return "";
        case MG_LINK:     return "ЗВ'ЯЗОК";
        case MG_REPAIR:   return "РЕМОНТ";
        case MG_CHARGE:    return "ЗАРЯД";
        case MG_DISCHARGE: return "РОЗРЯД";
        case MG_COUNTERS: return "ЛІЧИЛЬНИКИ";
        case MG_MODEL:    return "МОДЕЛЬ";
        case MG_NEW:      return "НОВИЙ ЧІП";
        case MG_DATA:     return "ДАНІ";
        case MG_SYSTEM:   return "СИСТЕМА";
        case MG_DANGER:   return "НЕБЕЗПЕЧНО";
        default:          return "";
    }
}

// Рід пункту: виконати операцію чи відкрити сторінку.
enum { MI_OP = 0, MI_PAGE = 1 };
// Сторінки, на які веде меню. Числа СВОЇ, не збігаються з PAGE_* у display.h
// навмисно: operations.h нічого не знає про екран і не мусить.
enum { MPG_HOME = 0, MPG_RAW38 = 1, MPG_RAW33 = 2, MPG_WIZARD = 3, MPG_COUNT = 4 };

// Скільки байт треба буферу під назву пункту. ⚠️ НЕ «на око»: назви з ціллю
// збираються на льоту, а кирилиця в UTF-8 — два байти на літеру, тож
// «Ціль заряду 100%» — це 16 літер, але 26 байт плюс нуль. Саме на такому
// буфері (26) назва й обрізалась до «Ціль заряду 100», без відсотка. Довжину
// перевіряє menu_check.
#define OP_NAME_BUF 48

// Як заповнюється відрізок меню.
enum { MS_OPS = 0,      // явний список кодів OP_*
       MS_MODELS,       // «Модель <X>» на кожен шаблон
       MS_NEW,          // «Новий <X>»  на кожен шаблон
       MS_EXPERT,       // явний список OP_*_REL (крайні операції)
       MS_PAGES };      // явний список MPG_*

struct MenuSeg { uint8_t group, kind; const int16_t *v; uint8_t n; };

static const int16_t MSEG_NAV[]      = { MPG_HOME };
// ⚑ ОДИН ПУНКТ — І ПЕРШИМ У СПИСКУ. Місце задав власник, і воно не випадкове:
//  до перемикача радіо доводиться діставатись саме тоді, коли зв'язку НЕМАЄ, —
//  а отже не через клієнта, а кнопками, наосліп. Кожен рядок над ним — це
//  натискання, яке робиться навпомацки.
//
//  ⚑ «ПЕРШИМ» ОЗНАЧАЄ ПЕРШИМ СЕРЕД ПУНКТІВ, А НЕ ПЕРЕД «‹ ПОКАЗАННЯ». Той
//  рядок — не пункт меню, а вихід із нього; курсор навмисно починається ПІСЛЯ
//  нього (g_menuSel = 1). Поставити перемикач над виходом означало б, що
//  дорога назад щоразу шукається під першим рядком, якого там більше немає.
//  А так курсор одразу стоїть на перемикачі: увійшов у меню — і він під
//  пальцем.
static const int16_t MSEG_LINK[]     = { OP_RADIO };
static const int16_t MSEG_REPAIR[]   = { OP_CELLSWAP, OP_CELLSWAP_DEEP, OP_REPAIR };
// ⚑ ОДНАКОВА ФОРМА В ОБОХ ГРУП, І ЦЕ НАВМИСНО: дія -> ціль -> ручні уставки
//  -> профіль. Раніше заряд і розряд лежали впереміш в одній групі
//  «ЖИВЛЕННЯ», і щоб знайти ціль розряду, доводилось проходити повз пункти
//  заряду. Тепер кожна машина — своя група тієї самої будови, і пробудження
//  стоїть останнім у заряді, бо це особливий СПОСІБ його почати.
static const int16_t MSEG_CHARGE[]   = { OP_CHARGE_DCDC, OP_CHARGE_TGT,
                                         OP_CHARGE_MANUAL_MV, OP_CHARGE_MANUAL_MA,
                                         OP_CHARGE_PROFILE, OP_CHARGE_WAKE };
static const int16_t MSEG_DISCHARGE[]= { OP_DISCHARGE, OP_DISCHARGE_TGT,
                                         OP_DIS_MANUAL_MA, OP_DIS_PROFILE };
static const int16_t MSEG_COUNTERS[] = { OP_SETCHARGE, OP_RESET, OP_CLEAN };
static const int16_t MSEG_DATA[]     = { MPG_RAW38, MPG_RAW33 };
static const int16_t MSEG_SYSPAGE[]  = { MPG_WIZARD };
static const int16_t MSEG_SYSOP[]    = { OP_REBOOT_REL };
static const int16_t MSEG_DANGER[]   = { OP_WIPE33_REL, OP_WIPE38_REL };

static const MenuSeg MENU_SEGS[] = {
    { MG_NAV,      MS_PAGES,   MSEG_NAV,      1 },
    { MG_LINK,     MS_OPS,     MSEG_LINK,     1 },
    { MG_REPAIR,   MS_OPS,     MSEG_REPAIR,   3 },
    { MG_CHARGE,   MS_OPS,     MSEG_CHARGE,   6 },
    { MG_DISCHARGE,MS_OPS,     MSEG_DISCHARGE,4 },
    { MG_COUNTERS, MS_OPS,     MSEG_COUNTERS, 3 },
    { MG_MODEL,    MS_MODELS,  nullptr,       0 },
    { MG_NEW,      MS_NEW,     nullptr,       0 },
    { MG_DATA,     MS_PAGES,   MSEG_DATA,     2 },
    { MG_SYSTEM,   MS_PAGES,   MSEG_SYSPAGE,  1 },
    { MG_SYSTEM,   MS_EXPERT,  MSEG_SYSOP,    1 },
    { MG_DANGER,   MS_EXPERT,  MSEG_DANGER,   2 },
};
#define MENU_SEG_COUNT ((int)(sizeof(MENU_SEGS) / sizeof(MENU_SEGS[0])))

// ── ЧИ ПОТРІБЕН ЦІЙ ОПЕРАЦІЇ ЗАРЯД ────────────────────────────────────────
//  Питання ставиться про КОД операції, а не про групу меню: меню — лише один
//  зі входів, і той самий код приходить із веба, з USB і зі збереженого
//  сценарію Майстра. Прибрати пункт з екрана й лишити його виконуваним ззовні
//  означало б вимкнути напис, а не функцію.
//
//  «Заряд з напруги» (OP_SETCHARGE) сюди НЕ входить, хоч і зветься схоже: він
//  нічого не заряджає, а вписує в паливомір відсоток, порахований із напруги
//  на клемах. Силова частина йому не потрібна, і на версії без заряду він
//  лишається робочим — це один із небагатьох способів привести паливомір до
//  тями саме там, де зарядити пакет нічим.
inline bool opNeedsCharge(int code) {
    switch (code) {
        case OP_CHARGE_DCDC:
        case OP_CHARGE_TGT:
        case OP_CHARGE_WAKE:
        case OP_CHARGE_PROFILE:
        case OP_CHARGE_MANUAL_MA:
        case OP_CHARGE_MANUAL_MV: return true;
        default:                  return false;
    }
}

inline int menuSegLen(int s) {
    const MenuSeg &g = MENU_SEGS[s];
    // Версія пристрою без заряду: група зникає ЦІЛКОМ, разом із заголовком.
    // Не «пункти сірі й не натискаються» — сіре меню на пів-екрана в приладі,
    // де заряду не передбачено взагалі, це не інформація, а перешкода.
    if (g.group == MG_CHARGE && !chargeAvailable()) return 0;
    if (g.kind == MS_MODELS || g.kind == MS_NEW) return BATTERY_TEMPLATE_COUNT;
    return g.n;
}

inline int menuCount() {
    int n = 0;
    for (int s = 0; s < MENU_SEG_COUNT; s++) n += menuSegLen(s);
    return n;
}

// Розкласти позицію меню на рід/код/групу. Повертає false для виходу за межі.
inline bool menuRow(int i, uint8_t *kind, int *code, uint8_t *group) {
    if (i < 0) return false;
    for (int s = 0; s < MENU_SEG_COUNT; s++) {
        int len = menuSegLen(s);
        if (i < len) {
            const MenuSeg &g = MENU_SEGS[s];
            *group = g.group;
            switch (g.kind) {
                case MS_OPS:    *kind = MI_OP;   *code = g.v[i];                 break;
                case MS_MODELS: *kind = MI_OP;   *code = opModelBase() + i;      break;
                case MS_NEW:    *kind = MI_OP;   *code = opNewBase() + i;        break;
                case MS_EXPERT: *kind = MI_OP;   *code = opExpertBase() + g.v[i];break;
                default:        *kind = MI_PAGE; *code = g.v[i];                 break;
            }
            return true;
        }
        i -= len;
    }
    return false;
}

// Чи починається на позиції i нова ГРУПА (треба малювати заголовок).
inline bool menuGroupStarts(int i) {
    uint8_t k, g, gp; int c;
    if (!menuRow(i, &k, &c, &g)) return false;
    if (i == 0) return true;
    uint8_t kp; int cp;
    if (!menuRow(i - 1, &kp, &cp, &gp)) return true;
    return gp != g;
}

// Назви «сторінкових» пунктів — коротко, під вузький екран пристрою.
inline const char *menuPageName(int page) {
    switch (page) {
        case MPG_HOME:   return "< Показання";
        case MPG_RAW38:  return "Дамп DS2438";
        case MPG_RAW33:  return "Дамп DS2433";
        case MPG_WIZARD: return "Майстер віднов.";
        default:         return "—";
    }
}
inline void menuPageDesc(int page, const char **l1, const char **l2) {
    switch (page) {
        case MPG_HOME:   *l1 = "вийти з меню до"; *l2 = "напруги й заряду";   break;
        case MPG_RAW38:  *l1 = "сирий вміст";     *l2 = "монітора, hex";      break;
        case MPG_RAW33:  *l1 = "сирий вміст";     *l2 = "пам'яті, hex";       break;
        case MPG_WIZARD: *l1 = "аналіз стану ->"; *l2 = "наступний крок";     break;
        default:         *l1 = "";                *l2 = "";                   break;
    }
}

// Межі ГРУПИ, у якій лежить пункт i, і стрибок на сусідню — це і є швидка
// навігація по довгому списку (довге натискання «‹»/«›»).
inline int menuGroupFirst(int i) {
    while (i > 0 && !menuGroupStarts(i)) i--;
    return i;
}
// Перший пункт НАСТУПНОЇ групи; по колу через кінець списку.
inline int menuNextGroup(int i) {
    int n = menuCount();
    for (int k = i + 1; k < n; k++) if (menuGroupStarts(k)) return k;
    return 0;
}
// Перший пункт ПОПЕРЕДНЬОЇ групи. Якщо курсор стоїть НЕ на першому пункті
// своєї групи — спершу вертаємось на її початок: так поводяться всі списки з
// такою навігацією, і це рятує від «промахнувся й полетів через усю групу».
inline int menuPrevGroup(int i) {
    int first = menuGroupFirst(i);
    if (i != first) return first;
    if (first == 0) {                       // з початку — по колу в останню
        int n = menuCount(), last = 0;
        for (int k = 0; k < n; k++) if (menuGroupStarts(k)) last = k;
        return last;
    }
    return menuGroupFirst(first - 1);
}

// Затиснути курсор у наявні межі. Потрібно щоразу, коли список МІГ стати
// коротшим під ногами: вимкнули заряд — шість пунктів зникло, і курсор, що
// стояв у кінці, показував би на порожнечу (menuRow() поверне false, і на
// екрані був би прочерк, який ні на що не реагує).
inline int menuClampSel(int sel) {
    int n = menuCount();
    if (n <= 0) return 0;
    if (sel < 0)  return 0;
    if (sel >= n) return n - 1;
    return sel;
}

// Повний опис пункту меню — те саме, що opInfo(), але для позиції в СПИСКУ.
// buf потрібен ≥26 байт (назви з моделлю чи ціллю збираються в нього).
inline void menuInfo(int i, const char **name, const char **l1, const char **l2,
                     uint8_t *danger, uint8_t *chips, char *buf, size_t bufN) {
    uint8_t kind = MI_OP, group = 0; int code = -1;
    if (!menuRow(i, &kind, &code, &group)) {
        *name = "—"; *l1 = ""; *l2 = ""; *danger = OPD_SAFE; *chips = OPC_NONE;
        return;
    }
    if (kind == MI_PAGE) {
        *name = menuPageName(code);
        menuPageDesc(code, l1, l2);
        *danger = OPD_SAFE; *chips = OPC_NONE;
        return;
    }
    opInfo(code, name, l1, l2, danger, buf, bufN, chips);
}

// Позиція операції в меню (для тестів і для наведення курсора). -1 — немає.
inline int menuIndexOfOp(int op) {
    int n = menuCount();
    for (int i = 0; i < n; i++) {
        uint8_t k, g; int c;
        if (menuRow(i, &k, &c, &g) && k == MI_OP && c == op) return i;
    }
    return -1;
}

// ---- описи для ВЕБ/десктоп (повні формулювання) ----------------------------
// Ті самі операції, але з розгорнутим поясненням. Віддаються в /api/ops і
// команді OPS, щоб веб і десктопний клієнт не тримали власних текстів.
struct OpDoc { const char *key, *title, *detail; uint8_t chips; };

// ⚠️ ПОРЯДОК ТУТ ЗОБОВ'ЯЗАНИЙ ЗБІГАТИСЯ З enum OP_* ВИЩЕ: /api/ops і команда
// OPS склеюють OP_DOC[i] із OP_TEXT[i]. Раніше «Розряд» і «Очистка історії»
// стояли навпаки, і в JSON опис однієї операції їхав із рівнем небезпеки
// іншої. Додаєте операцію — додайте рядок і сюди, у ТУ САМУ позицію.
static const OpDoc OP_DOC[OP_BASE_COUNT] = {
    { "cellswap", "Ремонт після заміни елементів",
      "Записує ЧИСТИЙ калібрувальний хвіст DS2433 (0x18A–0x1FF): скелет записів і сталі моделі лишаються, навчені значення старих (донорських) банок обнулені, контрольні суми правильні. Ідентичність, розрядна крива, COPYRIGHT, заводська таблиця й запис моделі не чіпаються. У DS2438 обнуляються лише лічильники; конфіг, апаратне калібрування АЦП струму й дзеркало зберігаються, паливомір — за напругою. ВАЖЛИВО: хвіст саме скидається, а не стирається в 0xFF — на стертому хвості зарядна станція не може записати навчену калібровку, і цикл щоразу завершується помилкою. Далі обов'язково повний цикл на IMPRES-ЗП.", OPC_BOTH },
    { "deep", "Глибока чистка",
      "Те саме, що «Ремонт після заміни елементів», плюс стирання навчених записів ємності (0x153–0x189) і журналу використання. Застосовуйте, лише якщо після звичайного ремонту зарядна станція тримається за стару ємність.", OPC_BOTH },
    { "repair", "Ремонт цілісності",
      "Перераховує контрольні суми: заголовок (Σ≡0x41) і всі записи ланцюга (Σ≡0x5A), синхронізує дзеркало DS2438↔DS2433. Дані не змінює — лише виправляє цілісність.", OPC_BOTH },
    { "setcharge", "Заряд із напруги",
      "Виставляє паливомір ICA за поточною напругою пакета: " BATTERY_SCALE_TXT ". Пише ЛИШЕ в DS2438 (регістр ICA). Зарядна станція згодом уточнить це значення сама.", OPC_38 },
    { "reset", "Скидання лічильників",
      "Обнуляє лічильники DS2438 (ETM напрацювання, CCA заряду, DCA розряду). Навчену калібровку й ідентичність не чіпає.", OPC_38 },
    { "clean", "Очистка історії",
      "Скидає лічильники використання, зберігаючи модель, ідентичність, розрядну криву й дзеркало.", OPC_BOTH },
    { "discharge", "Розряд перед калібруванням",
      "Вмикає навантаження (MOSFET + резистор) і розряджає пакет до заданої напруги, типово 7.20 В. Навіщо: це приймальний контроль після перепайки — рахується РЕАЛЬНА ємність нових банок. Для калібрування розряд НЕ обов'язковий: фірмова станція бере в цикл навіть повністю заряджений пакет, якщо він оригінальний; але якщо станція вперлась і не переходить у калібрування, часткова розрядка це підштовхує. Ємність рахується так: струм іде через вимірювальний резистор DS2438 усередині пакета, тож мА*год рахуються за фактом, без окремого шунта. Струм ОБМЕЖУЄТЬСЯ ШІМом і веде за напругою лінійно: 1000 мА на повному заряді (8.25 В) і далі вниз до 300 мА рівно на ОБРАНІЙ цільовій напрузі — малий струм у кінці не «продавлює» напругу передчасно й дає чесніший вимір ємності. Раз на 5 с знімаються напруга (при знятому навантаженні, без просадки) і пік струму (при повністю відкритому ключі), з них рахується шпаруватість; індикатор плавно дихає помаранчевим, дисплей переходить у режим моніторингу. Аварійна зупинка за напругою нижче 6.00 В, перегрівом, стелею часу, втратою зв'язку з монітором або зависанням головного циклу (сторожовий таймер знімає навантаження й сигнал enable).", OPC_38 },
    { "dischargetgt", "Цільова напруга розряду",
      "Перемикач цілі для розряду, запущеного з МЕНЮ ПРИСТРОЮ (у вебі й десктопі ціль набирається полем). Значення йде по колу 7.80 -> 7.60 -> 7.40 -> 7.20 -> 7.00 В і показується в назві обох пунктів розряду. Нічого не пише в чипи.", OPC_NONE },
    { "chargedcdc", "Керований заряд ШІМом (не плутати з «Заряд із напруги»!)",
      "Вмикає керований заряд ПОНИЖУВАЛЬНИМ ПЕРЕТВОРЮВАЧЕМ: біполярний PNP (B772M) у верхньому ключі, після нього діод на землю й дросель на вихід; ключем керує ШІМ через NPN (шпаруватість на піні = шпаруватість ключа, 0 % = закрито). Струм і напругу пристрій міряє САМ: спад на власному шунті 0.5 Ом у мінусовому проводі та подільник на плюсовій клемі — DS2438 потрібен лише для ТЕМПЕРАТУРИ пакета й читається рідко. Профіль струму 200->1000->100 мА за відсотком заряду (стелю задає теплова межа ключа, а не пакет), ціль — обраний відсоток; точки перегину МАСШТАБУЮТЬСЯ під ціль, тож заряд завжди закінчується плавним спадом. Оскільки у понижувача Uвих ≈ D × Uживл, струм з'являється лише вище D = Uпакета/Uживл — тому старт іде не з нуля, а з розрахованої шпаруватості (точка нульового струму), інакше розгін тривав би хвилини. Раз на секунду ключ на 10 мс закривається, щоб побачити напругу пакета без падіння на дротах; раз на 10 опитувань — довше, щоб прочитати температуру (шунт у мінусовому проводі підіймає «мінус» пакета над землею, і 1-Wire під струмом не відповідає). Пакет не прийме струм, доки не піднято enable-сигнал — прошивка тримає його сама. Аварійна зупинка за ПІКОМ струму (вершина пульсацій злітає, коли дросель випав із кола), напругою вище межі обраної цілі, перегрівом, стелею часу 6 год чи втратою зв'язку з монітором. Заряд і розряд не можуть іти одночасно.", OPC_38 },
    { "chargetgt", "Цільовий відсоток заряду",
      "Перемикач цілі для заряду, запущеного з МЕНЮ ПРИСТРОЮ (у вебі й десктопі ціль набирається полем/повзунком). Значення йде по колу 100 -> 95 -> 90 -> 85 -> 80 % і показується в назві обох пунктів заряду. Нижче за мінімально дозволений відсоток (типово 50 %) ціль не опускається. Нічого не пише в чипи.", OPC_NONE },
    { "chargeprofile", "Профіль заряду: заводський або розумний CC/CV",
      "Заводський профіль веде струм ТАБЛИЦЕЮ за відсотком заряду, однаковою для будь-якого пакета. Розумний рахує струм від ПАСПОРТНОЇ ЄМНОСТІ саме цього пакета (її прошивка бере з DS2433) у частках C і веде класичний літієвий цикл: передзаряд 0.1C нижче 3.00 В на банку, потім CC 0.5C, потім справжня фаза CV — уставка спадає в міру наближення до цілі, і заряд завершується за СТРУМОМ (0.05C), а не за дотиком до цільової напруги. Додатково діє температурне вікно 0…45 °C із половинним струмом нижче 10 °C: холодний і глибоко розряджений літій не можна бити повним струмом, на аноді росте металевий літій. Усі струми однаково затиснуті апаратними межами ключа.", OPC_NONE },
    { "chargema", "Ручний струм заряду",
      "Уставка струму замість автоматичної. 0 повертає автомат. Діє і ПІД ЧАС заряду: струм саме тоді й підбирають, дивлячись на нагрів. У зоні дозаряду (кінець заряду) ручне значення бере участь лише якщо воно МЕНШЕ за автоматичне — зменшити струм можна завжди, збільшити в кінці ні.", OPC_NONE },
    { "chargemv", "Ручна цільова напруга заряду",
      "Ціль у ВОЛЬТАХ замість відсотка. Відсоток проходить через криву SoC, тобто «85 %» — це стільки, скільки крива вважає за 85 %; для зберігання (7.4 В = 3.70 В на банку) і для ремонтних сценаріїв потрібні саме вольти. 0 повертає ціль за відсотком. Вище заводської цілі підняти не можна: аварійна межа сеансу рахується як ціль плюс запас.", OPC_NONE },
    { "disprofile", "Профіль розряду: заводська лінійка або розумний 0.2C",
      "Заводська лінійка веде струм за напругою від 1000 до 300 мА однаково для будь-якого пакета. Розумний рахує 0.2C від паспортної ємності — стандартна ставка саме для ВИМІРУ ємності: більший струм занижує результат просадкою на внутрішньому опорі, менший розтягує цикл на півдня. Плюс температурне вікно.", OPC_NONE },
    { "disma", "Ручний струм розряду",
      "Уставка струму замість лінійки за напругою. 0 повертає автомат. Біля самої цілі ручне значення, як і в заряді, бере участь лише якщо воно менше за автоматичне: малий струм у кінці не «продавлює» напругу передчасно й дає чесніший вимір ємності.", OPC_NONE },
    { "radio", "Зв'язок із клієнтами: Wi-Fi або Bluetooth",
      "Перемикає, яким радіо прилад розмовляє з клієнтами, і застосовується ПРИ НАСТУПНОМУ СТАРТІ — прилад перезавантажується сам одразу після вибору. Разом стеки не піднімаються навмисно: радіо в ESP32 одне, а Bluedroid бере ~70 КБ купи одним шматком, і саме через це раніше «з увімкненим Bluetooth пристрій переставав під'єднуватись по Wi-Fi». У режимі Bluetooth точка доступу, captive-portal і веб-сервер НЕ піднімаються взагалі, а прилад видно як звичайний COM-порт (SPP) — тими самими клієнтами, тільки через інший порт; запис по радіо вимагає AUTH. Якщо Bluetooth не піднявся (не та схема розділів або бракує пам'яті), прилад свідомо вмикає Wi-Fi, щоб не лишитись без зв'язку взагалі, і каже про це в журналі. ⚠️ Перемикання розриває поточне з'єднання: віддавши цю команду з веб-клієнта, ви втрачаєте його до повернення в режим Wi-Fi — а повернути режим можна кнопками приладу, меню «ЗВ'ЯЗОК». Нічого не пише в чипи.", OPC_NONE },
};

// ⚑ ТАБЛИЦІ ЗБІГАЮТЬСЯ ЗА ДОВЖИНОЮ — І ЦЕ ПЕРЕВІРЯЄТЬСЯ НА КОМПІЛЯЦІЇ.
//  Обидві заповнюються ЗА ІНДЕКСОМ, а C++ мовчки занулює те, чого бракує: не
//  дописавши рядок про нову операцію, ми дістали б OP_DOC[i].key == nullptr —
//  і клієнт отримав би JSON із падінням на String(nullptr) замість опису.
//  Помилки збірки при цьому не було б жодної.
static_assert(sizeof(OP_DOC) / sizeof(OP_DOC[0]) == OP_BASE_COUNT,
              "OP_DOC не збігається з OP_BASE_COUNT: додали операцію — додайте рядок і сюди.");
static_assert(sizeof(OP_TEXT) / sizeof(OP_TEXT[0]) == OP_BASE_COUNT,
              "OP_TEXT не збігається з OP_BASE_COUNT.");

static const OpDoc OP_DOC_EXPERT[OP_EXPERT_COUNT] = {
    { "wipe33", "Повне стирання DS2433",
      "Заповнює всі 512 байт значенням 0xFF. Стирає ВСЕ, включно з моделлю та ідентичністю. Після цього АКБ не працюватиме, доки не записати модельну частину еталона. Крайній випадок.", OPC_33 },
    { "wipe38", "Повне стирання DS2438",
      "Заповнює монітор 0xFF. Дзеркало ідентичності й апаратне калібрування АЦП струму буде втрачено. Крайній випадок — у штатному ремонті НЕ потрібно: «Ремонт після заміни елементів» обнуляє лише лічильники.", OPC_38 },
    { "reboot", "Перезавантаження", "Рестарт ESP32 (Wi-Fi, веб-сервер).", OPC_NONE },
};

#endif // OPERATIONS_H
