#pragma once
// ===========================================================================
//  splash.h — КОЛЬОРОВА ЗАСТАВКА, ЗАВАНТАЖЕНА У SPIFFS
// ===========================================================================
//  Досі кастомна заставка вимагала перезбирання прошивки: конвертер
//  tools/make_color_splash.py робив custom_splash.h із C-масивом, файл
//  клався в теку скетчу, і далі — Arduino IDE, компіляція, прошивання.
//  Помінялась картинка — усе спочатку.
//
//  Тепер її можна просто ЗАВАНТАЖИТИ у SPIFFS через веб-інтерфейс. Прошивка
//  лишається тією самою, картинка живе у файловій системі поруч із index.html.
//
//  ⚑ ЛИШЕ ДЛЯ КОЛЬОРОВИХ ПАНЕЛЕЙ (display_color.h, ST7789). На монохромному
//  OLED зберігати RGB565 нема сенсу — там інший конвеєр (XBM у display.h).
//
// ── ЧОМУ СИРИЙ RGB565, А НЕ PNG/JPEG ──────────────────────────────────────
//  Спокуса «хай вантажать PNG» коштує дорого: декодер тягне за собою
//  бібліотеку, купу пам'яті під час розпакування і цілий клас нових способів
//  впасти на кривому файлі — і все це заради картинки, яку показують півтори
//  секунди при старті. Сирий RGB565 не декодується взагалі: байти з файла
//  йдуть у шину дисплея як є.
//
//  Порядок байтів — СТАРШИЙ ПЕРШИМ (big-endian), тобто рівно той, у якому їх
//  чекає ST7789. Це не дрібниця: ESP32 little-endian, і якби ми зберігали
//  «як у пам'яті», кожен піксель довелося б перевертати на льоту. При такому
//  зберіганні перевертати не треба нічого — writePixels() віддає буфер у шину
//  напряму (bigEndian=true).
//
// ── ЗАГОЛОВОК: 8 БАЙТІВ, І ВІН ТУТ НЕ ДЛЯ КРАСИ ───────────────────────────
//    0..3  магія 'M','B','S','1'
//    4..5  ширина, пікселів  (little-endian)
//    6..7  висота, пікселів  (little-endian)
//    8..   w*h*2 байтів RGB565, big-endian, рядками зверху вниз
//
//  Без заголовка єдиною перевіркою лишався б розмір файла — а це означає, що
//  будь-який чужий файл потрібної довжини пройшов би як картинка й вивалився
//  на екран шумом. Магія відсікає «завантажив не те» одразу й дозволяє
//  сказати про це людськими словами замість «щось не так».
//  Розміри в заголовку, а не «завжди на весь екран», щоб та сама картинка
//  лягала на панелі різної висоти (240x240, 240x280, 240x320) — менша просто
//  центрується.
// ===========================================================================

#include <stdint.h>
#include <stddef.h>

#define SPLASH_MAGIC0 'M'
#define SPLASH_MAGIC1 'B'
#define SPLASH_MAGIC2 'S'
#define SPLASH_MAGIC3 '1'
#define SPLASH_HDR_BYTES 8

// Причини, з яких файл не годиться. Окремим переліком, а не рядками, бо той
// самий розбір потрібен і на прийманні (веб), і на показі (дисплей), і в
// хостовому тесті — а тексти в цих трьох місцях різні.
enum {
    SPLASH_OK = 0,
    SPLASH_ERR_SHORT,      // файл коротший за заголовок
    SPLASH_ERR_MAGIC,      // не наша картинка (PNG, JPEG, будь-що інше)
    SPLASH_ERR_ZERO,       // нульова ширина або висота
    SPLASH_ERR_TOO_BIG,    // не влазить у панель
    SPLASH_ERR_SIZE,       // довжина не збігається із заявленими розмірами
};

inline const char *splashErrText(int e) {
    switch (e) {
        case SPLASH_OK:          return "ок";
        case SPLASH_ERR_SHORT:   return "файл коротший за заголовок — це не заставка";
        case SPLASH_ERR_MAGIC:   return "не той формат: потрібен .bin RGB565 із заголовком MBS1, а не PNG/JPEG";
        case SPLASH_ERR_ZERO:    return "у заголовку нульовий розмір";
        case SPLASH_ERR_TOO_BIG: return "картинка більша за екран";
        case SPLASH_ERR_SIZE:    return "довжина файла не збігається з розмірами із заголовка";
        default:                 return "невідома помилка";
    }
}

// Розібрати заголовок і звірити його з довжиною файла та розміром панелі.
//  hdr    — перші SPLASH_HDR_BYTES байтів файла;
//  nHdr   — скільки байтів заголовка справді прочиталось (може бути менше);
//  fileSz — повна довжина файла;
//  wOut/hOut — розміри картинки, якщо все гаразд.
//
//  ⚑ Перевіряємо ВСЕ і саме в цьому порядку: спершу чи є що читати, потім чи
//  наше це взагалі, і лише тоді — арифметику розмірів. Зворотний порядок дав
//  би «довжина не збігається» на звичайному PNG, тобто повідомлення, яке
//  веде не туди.
inline int splashParse(const uint8_t *hdr, size_t nHdr, size_t fileSz,
                       uint16_t panelW, uint16_t panelH,
                       uint16_t *wOut, uint16_t *hOut) {
    if (wOut) *wOut = 0;
    if (hOut) *hOut = 0;
    if (nHdr < SPLASH_HDR_BYTES || fileSz < SPLASH_HDR_BYTES) return SPLASH_ERR_SHORT;
    if (hdr[0] != SPLASH_MAGIC0 || hdr[1] != SPLASH_MAGIC1 ||
        hdr[2] != SPLASH_MAGIC2 || hdr[3] != SPLASH_MAGIC3) return SPLASH_ERR_MAGIC;

    uint16_t w = (uint16_t)(hdr[4] | ((uint16_t)hdr[5] << 8));
    uint16_t h = (uint16_t)(hdr[6] | ((uint16_t)hdr[7] << 8));
    if (w == 0 || h == 0) return SPLASH_ERR_ZERO;
    if (w > panelW || h > panelH) return SPLASH_ERR_TOO_BIG;

    // 32-бітного множення тут вистачає з великим запасом (240×320×2 = 153 600),
    // але рахуємо в uint32_t явно: на 16-бітному int цей вираз переповнився б
    // мовчки, і перевірка розміру перетворилась би на випадкове число.
    uint32_t need = (uint32_t)w * (uint32_t)h * 2u + SPLASH_HDR_BYTES;
    if ((uint32_t)fileSz != need) return SPLASH_ERR_SIZE;

    if (wOut) *wOut = w;
    if (hOut) *hOut = h;
    return SPLASH_OK;
}

// Скільки байтів займе картинка заданого розміру — разом із заголовком.
// Потрібно і приймальнику (щоб відхилити завелике ДО запису у SPIFFS), і
// клієнту (щоб показати розмір людині ще до надсилання).
inline uint32_t splashBytesFor(uint16_t w, uint16_t h) {
    return (uint32_t)w * (uint32_t)h * 2u + SPLASH_HDR_BYTES;
}

// ═══ JPEG ═════════════════════════════════════════════════════════════════
//  Спершу тут свідомо підтримувався ЛИШЕ сирий RGB565, і аргумент був такий:
//  декодер тягне бібліотеку, пам'ять під розпакування і новий клас падінь на
//  кривому файлі — заради картинки, яку показують півтори секунди.
//
//  Власник попросив вантажити просто JPEG. Аргумент проти нікуди не подівся,
//  але в нього є й другий бік, який переважує: 240×240 RGB565 — це 113 КБ у
//  файловій системі, а той самий кадр у JPEG — 10…30 КБ. На SPIFFS, де вже
//  лежить index.html на 226 КБ, різниця в сотню кілобайтів відчутна. Плюс
//  зникає крок перетворення: користувач кладе те, що в нього є.
//
//  Тому підтримуються ОБИДВА формати, і тип визначається за МАГІЄЮ файла, а
//  не за розширенням чи полем форми: розширення бреше, а перші байти — ні.
//
//  Декодер — TJpg_Decoder (Bodmer), із бібліотек Arduino. Він розбирає JPEG
//  блоками MCU й віддає їх у callback, тобто цілий кадр у пам'яті не тримає.
//  Якщо бібліотеки немає, збірка скаже про це прямо (див. settings.h), а не
//  впаде десь усередині.
#define SPLASH_KIND_NONE 0
#define SPLASH_KIND_RAW  1     // наш .bin: 'MBS1' + RGB565
#define SPLASH_KIND_JPEG 2     // звичайний JPEG/JFIF/EXIF

// Що це за файл — за першими байтами.
//  JPEG завжди починається з SOI (FF D8) і одразу за ним іде маркер (FF xx).
//  Перевіряємо всі три байти, а не два: FF D8 трапляється й усередині
//  довільних даних, а FF D8 FF — уже майже напевно JPEG.
inline int splashSniff(const uint8_t *b, size_t n) {
    if (n >= 3 && b[0] == 0xFF && b[1] == 0xD8 && b[2] == 0xFF) return SPLASH_KIND_JPEG;
    if (n >= 4 && b[0] == SPLASH_MAGIC0 && b[1] == SPLASH_MAGIC1 &&
                  b[2] == SPLASH_MAGIC2 && b[3] == SPLASH_MAGIC3) return SPLASH_KIND_RAW;
    return SPLASH_KIND_NONE;
}

// Чи лягає розкодований JPEG на панель. Окремою функцією — щоб приймальник і
// дисплей вирішували це однаково, і щоб хостовий тест міг це перевірити.
//  Менша за екран картинка законна: її центрують, як і сирий .bin.
inline bool splashJpegFits(uint16_t w, uint16_t h, uint16_t panelW, uint16_t panelH) {
    return w > 0 && h > 0 && w <= panelW && h <= panelH;
}
