#pragma once
// ===========================================================================
//  wdt.h — АПАРАТНИЙ СТОРОЖ (Task WDT) НА ЧАС ЗАРЯДУ Й РОЗРЯДУ
// ===========================================================================
//  Заряд і розряд — єдині режими, де зависання головного циклу небезпечне
//  фізично: ключ лишається відкритим, струм тече, а зупинити його зсередини
//  нікому. Тому на час цих двох операцій (і ТІЛЬКИ на цей час) вмикається
//  Task WDT: якщо цикл не подав ознак життя за N секунд — ESP32 скидається,
//  піни стають входами, ключ закривається підтяжкою, enable падає, пакет
//  від'єднується сам.
//
//  Постійно тримати сторожа не можна: запис DS2433, форматування SPIFFS і
//  перше підняття Wi-Fi законно тривають довше за будь-який розумний поріг.
//
//  Раніше цей код був СКОПІЙОВАНИЙ у charge.h і discharge.h — двома майже
//  однаковими копіями. Разом із кодом скопіювалась і помилка, описана нижче,
//  тож ловити її довелось двічі. Тепер обидва модулі кличуть звідси.
//
// ── ГОЛОВНЕ: IDLE-ЗАДАЧІ СТОРОЖУ ВІДДАВАТИ НЕ МОЖНА ───────────────────────
//  У ESP-IDF 5 (arduino-esp32 3.x) сторож налаштовується структурою, у якій є
//  поле idle_core_mask — перелік бездіяльних (IDLE) задач, які теж мусять
//  «відмічатися». Стояло там ось це:
//
//      (uint32_t)(1 << portNUM_PROCESSORS) - 1      // = 0b11, ОБИДВА ядра
//
//  На вигляд — «хай стежить за всім, гірше не буде». Насправді це причина
//  скарги «під час заряду або розряду пристрій періодично перезавантажується».
//
//  Чому. Скетч Arduino крутиться в задачі loopTask із пріоритетом 1, прибитій
//  до ядра 1. IDLE1 має пріоритет 0, тобто отримує процесор ЛИШЕ тоді, коли
//  loopTask заблокується. Наш loop() не блокувався ніде: ні delay(), ні
//  vTaskDelay() — суцільне неблокуюче опитування, чим ми, власне, й пишалися.
//  Отже IDLE1 не виконувалась, сторожа не годувала — і рівно через
//  CHARGE_WDT_SEC (10 с) чи DISCHARGE_WDT_SEC (30 с) прошивка падала в паніку
//  «Task watchdog got triggered … IDLE1» і пристрій ішов на перезавантаження.
//  Не через збій заряду. Через самого сторожа.
//
//  Саме тому arduino-esp32 у своїй типовій конфігурації вмикає перевірку
//  IDLE0 і НЕ вмикає IDLE1: автори знають, що цикл Arduino окупує ядро 1.
//  Наш виклик esp_task_wdt_init() мовчки скасовував це рішення.
//
//  «Періодично», а не «завжди» — бо зрідка цикл усе ж блокувався: звернення
//  веб-клієнта, робота зі SPIFFS, Serial.flush(), плавні згасання підсвітки.
//  Кожна така пауза давала IDLE1 шанс відмітитись і відсувала падіння. Тиха
//  зарядка без під'єднаного клієнта падала найшвидше — і це збігається з тим,
//  як воно поводилось насправді.
//
//  Тому маска тут ЖОРСТКО НУЛЬОВА. Сторож стежить за тією однією задачею, яка
//  справді керує ключем, — за нашою. Це не послаблення: саме її зависання ми
//  й ловимо, а IDLE-задачі не керують нічим.
//
//  Другий бік тієї ж проблеми — не в сторожі, а в циклі: IDLE-задача мусить
//  діставати процесор і без сторожа, бо саме вона звільняє пам'ять видалених
//  задач FreeRTOS. Через це наприкінці loop() тепер стоїть delay(1); див.
//  motorola-battery-reader-web.ino.
//
// ── ДРУГЕ: НЕ РУЙНУВАТИ СТОРОЖА, ЯКОГО СТВОРИЛИ НЕ МИ ─────────────────────
//  На зупинці стояло esp_task_wdt_deinit() — «прибрати за собою». Але сторожа
//  на цьому пристрої створюємо не ми: arduino-esp32 піднімає його ще до
//  setup() (CONFIG_ESP_TASK_WDT_INIT) і підписує туди IDLE0. Наш deinit
//  зносив увесь механізм цілком, і після першого ж заряду пристрій до кінця
//  сеансу лишався взагалі без Task WDT — тобто справжнє зависання циклу вже
//  ніхто не ловив. Тепер на зупинці ми лише відписуємось і ПОВЕРТАЄМО
//  завантажувальні налаштування; deinit робиться тільки там, де сторожа при
//  старті справді не було.
// ===========================================================================

#include <stdint.h>
#include <stddef.h>        // NULL — esp_task_wdt_add(NULL) означає «поточна задача».
                           // Раніше приходив транзитом із чужих заголовків: на
                           // цільовій збірці працювало, але тримати чужий
                           // include як умову власної збірки не варто.

#if defined(ARDUINO_ARCH_ESP32)
  #include <esp_task_wdt.h>
  #include <sdkconfig.h>
  // ⚑ ESP_ARDUINO_VERSION_MAJOR — НЕ з esp_task_wdt.h, а з окремого заголовка.
  //  Нижче на ньому тримається вибір між двома несумісними виглядами
  //  esp_task_wdt_init(). Якщо макрос не визначений, препроцесор мовчки
  //  вважає його нулем (той самий «мовчазний нуль», на якому цей проєкт уже
  //  двічі горів у settings.h) — і збірка на ядрі 3.x пішла б гілкою для 2.x,
  //  де в init() інша сигнатура. Помилка була б гучна, але шукати її довелось
  //  би не там, тож підстраховуємось явно.
  #if __has_include(<esp_arduino_version.h>)
    #include <esp_arduino_version.h>
  #endif
  #if !defined(ESP_ARDUINO_VERSION_MAJOR)
    #error "ESP_ARDUINO_VERSION_MAJOR невідомий: wdt.h не може обрати правильний вигляд esp_task_wdt_init(). Підключіть <Arduino.h> раніше за wdt.h."
  #endif
#endif

// Маска IDLE-задач на час заряду/розряду. Нуль — і жодного «налаштування»
// тут бути не може: будь-яке інше значення повертає ту саму перезавантажку.
#define WDT_WATCH_IDLE_MASK 0u

// Завантажувальний поріг сторожа, с (той, з яким його підняв arduino-esp32).
#if defined(CONFIG_ESP_TASK_WDT_TIMEOUT_S)
  #define WDT_BOOT_SEC (CONFIG_ESP_TASK_WDT_TIMEOUT_S)
#else
  #define WDT_BOOT_SEC 5
#endif

// Чи був сторож піднятий ДО setup(). Від цього залежить, що робити на
// зупинці: відновити чуже налаштування чи прибрати своє.
#if defined(CONFIG_ESP_TASK_WDT_INIT) || defined(CONFIG_ESP_TASK_WDT)
  #define WDT_INITED_AT_BOOT 1
#else
  #define WDT_INITED_AT_BOOT 0
#endif

// Завантажувальна маска IDLE-задач — саме та, яку виставив arduino-esp32.
// Типово це «IDLE0 так, IDLE1 ні»; читаємо з конфігурації, а не вгадуємо.
inline uint32_t wdtBootIdleMask() {
    uint32_t m = 0;
#if defined(CONFIG_ESP_TASK_WDT_CHECK_IDLE_TASK_CPU0)
    m |= 1u << 0;
#endif
#if defined(CONFIG_ESP_TASK_WDT_CHECK_IDLE_TASK_CPU1)
    m |= 1u << 1;
#endif
    return m;
}

// Маска на час нашої операції. Окремою функцією (а не числом на місці
// виклику), щоб хостовий тест міг перевірити її напряму.
inline uint32_t wdtWatchIdleMask() { return WDT_WATCH_IDLE_MASK; }

#if defined(ARDUINO_ARCH_ESP32) && ESP_ARDUINO_VERSION_MAJOR >= 3
// ── ЗАСТОСУВАТИ НАЛАШТУВАННЯ СТОРОЖА ──────────────────────────────────────
//  ⚑ esp_task_wdt_init() ПРАЦЮЄ ЛИШЕ ОДИН РАЗ. Якщо сторож уже піднятий — а він
//  піднятий, arduino-esp32 робить це ще до setup() (CONFIG_ESP_TASK_WDT_INIT), —
//  він повертає ESP_ERR_INVALID_STATE і НІЧОГО НЕ МІНЯЄ. Мовчки.
//
//  Саме це й ловилось у журналі з пристрою:
//      E (64046) task_wdt: esp_task_wdt_init(517): TWDT already initialized
//  тобто ВСЯ наша настройка сторожа (і поріг, і нульова маска IDLE) не
//  застосовувалась ЖОДНОГО разу. Помилка тим неприємніша, що виглядала як
//  робочий код: підписка esp_task_wdt_add() далі відпрацьовувала успішно, і
//  зовні все здавалось налаштованим.
//
//  Для ЗМІНИ налаштувань уже піднятого сторожа є окремий виклик —
//  esp_task_wdt_reconfigure(). Пробуємо init (раптом сторожа й справді немає),
//  а на ESP_ERR_INVALID_STATE переходимо на reconfigure.
inline bool wdtApplyConfig(const esp_task_wdt_config_t *cfg) {
    esp_err_t e = esp_task_wdt_init(cfg);
    if (e == ESP_ERR_INVALID_STATE) e = esp_task_wdt_reconfigure(cfg);
    if (e != ESP_OK)
        Serial.printf("WDT: не вдалося застосувати налаштування (%d)\n", (int)e);
    return e == ESP_OK;
}
#endif

// Увімкнути/вимкнути сторожа на час операції. sec — поріг у секундах.
inline void wdtGuard(bool on, uint32_t sec) {
#if defined(ARDUINO_ARCH_ESP32)
  #if ESP_ARDUINO_VERSION_MAJOR >= 3
    if (on) {
        esp_task_wdt_config_t cfg = { sec * 1000U, wdtWatchIdleMask(), true };
        wdtApplyConfig(&cfg);
        esp_task_wdt_add(NULL);
    } else {
        esp_task_wdt_delete(NULL);
    #if WDT_INITED_AT_BOOT
        // Повертаємо те, що було до нас, а не зносимо механізм.
        esp_task_wdt_config_t cfg = { (uint32_t)WDT_BOOT_SEC * 1000U,
                                      wdtBootIdleMask(), true };
        wdtApplyConfig(&cfg);
    #else
        esp_task_wdt_deinit();
    #endif
    }
  #else
    // arduino-esp32 2.x: IDLE-задачі підписуються окремим викликом, тобто
    // самé esp_task_wdt_init() їх не чіпає — описаної вище пастки тут немає.
    if (on) { esp_task_wdt_init(sec, true); esp_task_wdt_add(NULL); }
    else    { esp_task_wdt_delete(NULL); esp_task_wdt_deinit(); }
  #endif
#else
    (void)on; (void)sec;
#endif
}

// Погодувати сторожа. Кличеться звідусіль, де цикл ще живий; поза операцією
// (коли ми не підписані) виклик безпечний — повертає помилку й нічого більше.
inline void wdtFeed() {
#if defined(ARDUINO_ARCH_ESP32)
    esp_task_wdt_reset();
#endif
}
