#ifndef IMPRES_FORMAT_H
#define IMPRES_FORMAT_H
// ===========================================================================
//  impres_format.h — ФОРМАТ ПРОШИВКИ IMPRES (DS2433 512 Б + DS2438 64 Б).
//
//  Єдине місце, де описано структуру прошивки. Чисті функції над буферами,
//  без глобальних змінних — щоб один і той самий код використовували веб,
//  екранне меню, USB-міст і десктопний клієнт.
//
//  Побудовано на повторному аналізі 49 реальних АКБ з dumps/ (98 файлів),
//  де кожен дамп має опис поведінки рації/ЗП від власника. Деталі й докази —
//  у docs/FIRMWARE_ANALYSIS.md.
//
//  ──────────────────────────────────────────────────────────────────────────
//  1. ЗАПИСИ (records)
//  ──────────────────────────────────────────────────────────────────────────
//  Уся змістовна частина DS2433 — ланцюг записів однакового вигляду:
//
//      [ДОВЖИНА][дані ...][КОНТРОЛЬНА СУМА]      Σ усіх байт запису ≡ 0x5A
//
//  ДОВЖИНА — це ПОВНА довжина запису разом із самим байтом довжини й сумою.
//  Проміжки між записами заповнені 0xFF. Ланцюг «упакований» до кінця чипа:
//  останній запис завершується рівно на 0x200.
//
//  ⚠️ РАНІШЕ у проєкті запис шукали як «тег + 0x00» (find_record/decodeCapacity),
//  тобто перший байт вважали ТЕГОМ. Це помилка: перший байт — довжина, а другий
//  байт довільний. Через це «ємність» читалася з фіксованого зсуву +21 у першому
//  ж записі довжини 0x17 і ЗАВЖДИ давала 100% (див. п.4).
//
//  ──────────────────────────────────────────────────────────────────────────
//  2. КАРТА ПАМ'ЯТІ DS2433
//  ──────────────────────────────────────────────────────────────────────────
//  0x000..0x01F  Заголовок ідентичності. Σ(0x00..0x1F) ≡ 0x41 (0x1F — сума).
//  0x020..0x065  Профіль моделі: службовий блок + розрядна крива.
//                Байт 0x041 — лічильник записів (змінюється), решта — стала.
//  0x066..0x0DF  Кільцевий ЖУРНАЛ використання (записи різної довжини).
//  0x0E0..0x0FF  Рядок COPYRIGHT20xx MOTOROLASOLUTIONS (формати 2014/2021).
//  0x100..0x11F  Продовження журналу використання.
//  0x120..0x13F  ЗАВОДСЬКА таблиця (запис 0x17 @0x129). Однакова для всіх
//                екземплярів моделі — це НЕ поточне здоров'я АКБ.
//  0x140..0x152  Запис МОДЕЛІ (0x0B @0x148: 9 символів ASCII + сума).
//  0x153..0x189  Навчені записи ємності (пишуться ЗП під час калібрування).
//  0x18A..0x1FF  ⚑ НАВЧЕНИЙ КАЛІБРУВАЛЬНИЙ ХВІСТ. Саме він блокує АКБ після
//                заміни елементів (див. п.3).
//
//  Діапазон 0x000..0x065 БАЙТ-У-БАЙТ однаковий у всіх екземплярів однієї
//  моделі (перевірено: 19×PMNN4409A, 8×PMNN4409B, 8×PMNN4488A, 3×PMNN4493A,
//  3×PMNN4809A). Це і є «прошивка моделі». Все, що вище 0x066, — індивідуальне.
//
//  ──────────────────────────────────────────────────────────────────────────
//  3. ЧОМУ ПІСЛЯ ЗАМІНИ ЕЛЕМЕНТІВ РАЦІЯ КАЖЕ «НЕВІДОМИЙ АКУМУЛЯТОР»
//  ──────────────────────────────────────────────────────────────────────────
//  Заголовок і профіль моделі у «непрацюючих» АКБ ІДЕНТИЧНІ робочим — справа
//  не в ідентичності. Блокує НАВЧЕНИЙ ХВІСТ 0x18A..0x1FF: він описує реальні
//  банки (виміряні ємність/імпеданс), і після заміни елементів суперечить
//  новому пакету. Рація/ЗП звіряють його з поведінкою АКБ і відкидають пакет.
//
//  Якщо хвіст ВІДСУТНІЙ або невалідний, рація приймає АКБ як фірмовий і просить
//  калібрування (dumps/13-dozaryadka-na-stantsii, 11-chastkove-stirannya).
//  І навпаки, dumps/08-nova-batareya: записано ПОВНИЙ еталон разом із ЧУЖИМ
//  хвостом → «невідомий акумулятор», ЗП лише світить зеленим.
//
//  ⚠️ АЛЕ СТИРАТИ ХВІСТ У 0xFF НЕ МОЖНА. Зарядна станція пише навчені значення
//  за ФІКСОВАНИМИ адресами і НЕ створює структуру записів заново. Доказ —
//  dumps/13-dozaryadka-na-stantsii: у дампі 01 хвіст стертий, після ПОВНОГО
//  циклу на ЗП у дампі 02 з'явилися рівно ДВА байти (0x1E1, 0x1E2), а байт
//  довжини 0x1E0 лишився 0xFF. На стертому хвості навчена калібровка не стане
//  валідною ніколи: рація АКБ приймає, але калібрування завершується помилкою —
//  саме це й спостерігалось на практиці.
//
//  Звідси РЕМОНТ ПІСЛЯ ЗАМІНИ ЕЛЕМЕНТІВ = записати ЧИСТИЙ хвіст:
//  скелет записів і сталі моделі лишаються, навчені значення обнулені, суми
//  перераховані (шаблони TPL_*_FRESH у templates.h). Плюс DS2438 у стан
//  «новий пакет». Ідентичність, крива, copyright, заводська таблиця й модель
//  не чіпаються.
//
//  ──────────────────────────────────────────────────────────────────────────
//  4. ЧОГО В ПРОШИВЦІ НЕМАЄ
//  ──────────────────────────────────────────────────────────────────────────
//  • «Здоров'я / строк служби, %» — НЕ зберігається. Перебір усіх зсувів по
//    7 АКБ із відомими показами рації (97/100/100/34/100/100/99 %) не дав
//    жодного збігу. Рація рахує цей відсоток сама з навчених даних.
//    Тому impresFactoryHealth() позначено як ЗАВОДСЬКУ таблицю, а не здоров'я.
//  • «Дата першого користування» — теж НЕ зберігається. Перебір 6 АКБ із
//    відомими датами по всіх зсувах і 10 кодуваннях (unix32, days-since-epoch,
//    DOS-date, BCD, y/m/d) не дав збігу в жодному спільному полі. Рація
//    обчислює дату як «зараз − ETM» (лічильник напрацювання DS2438).
//  Обидва показники позначаємо як «рахує рація», а не вигадуємо число.
//
//  ──────────────────────────────────────────────────────────────────────────
//  5. DS2438 (монітор)
//  ──────────────────────────────────────────────────────────────────────────
//  0x00        статус/конфіг (у всіх справних АКБ = 0x0F)
//  0x01..0x02  температура (LSB, MSB)
//  0x03..0x04  напруга (LSB, MSB), одиниця 10 мВ
//  0x05..0x06  струм (LSB, MSB), зі знаком
//  0x07        поріг (у всіх справних АКБ = 0x40)
//  0x08..0x0B  ETM — лічильник напрацювання, 4 байти LE, секунди
//  0x0C        ICA — паливомір (1 байт)
//  0x0D..0x0E  OFFSET — апаратне калібрування АЦП струму (0x0018) — НЕ чіпати
//  0x0F        0xFC (стале)
//  0x18..0x31  ДЗЕРКАЛО DS2433[0x01..0x1A]
//  0x3C..0x3D  CCA (LE)   0x3E..0x3F  DCA (LE)
// ===========================================================================

#include <stdint.h>
#include <string.h>
#include "soc.h"   // таблична крива заряду за напругою (2S)

#define IMPRES_33_SIZE        512
#define IMPRES_38_SIZE        64

// ---- межі регіонів DS2433 --------------------------------------------------
#define IMPRES_HDR_END        0x020   // заголовок 0x000..0x01F, Σ≡0x41
#define IMPRES_ID_END         0x066   // кінець блока моделі (ідентичність+крива)
#define IMPRES_ID_COUNTER     0x041   // лічильник записів усередині блока моделі
#define IMPRES_LOG_BEGIN      0x066   // журнал використання
#define IMPRES_COPYRIGHT      0x0E0   // рядок COPYRIGHT20xx (32 Б)
#define IMPRES_LOG2_BEGIN     0x100
#define IMPRES_FACTORY_REC    0x129   // заводська таблиця, довжина 0x17
#define IMPRES_MODEL_REC      0x148   // запис моделі, довжина 0x0B
#define IMPRES_MODEL_LEN      0x0B
#define IMPRES_MODEL_CHARS    9
#define IMPRES_LEARNED_BEGIN  0x18A   // ⚑ навчений калібрувальний хвіст
#define IMPRES_LEARNED_END    IMPRES_33_SIZE

#define IMPRES_REC_SUM        0x5A    // Σ байт запису
#define IMPRES_HDR_SUM        0x41    // Σ байт заголовка

// ---- ТРЕТЯ контрольна сума: блок профілю моделі ----------------------------
//  Знайдена перебором УСІХ 131 328 діапазонів дампа на адитивний і XOR-інваріант
//  по 23 дампах із цілою ідентичністю: єдиний діапазон, де згортка стала, а
//  байти РІЗНІ, — це 0x021..0x040, Σ ≡ 0x00. Перевірено на всіх 49 дампах
//  dumps/ — тримається в 49 з 49, зокрема в усіх несправних.
//
//  Це та сама структура, що й «заголовок»: насправді чип починається двома
//  32-байтними блоками, кожен із яких дає нуль, а звичне «Σ(0x000..0x01F) ≡
//  0x41» — лише інший запис того самого факту (0x41 = d[0x00] − d[0x20] =
//  0x8D − 0x4C, і обидва ці байти сталі в усіх дампах).
//
//  ⚠️ Свідомо лише ПЕРЕВІРКА, без автоматичного виправлення: блок 0x021..0x040
//  входить у модельну частину (0x000..0x065), яка побайтово однакова в усіх
//  екземплярів моделі. Який саме байт там компенсаційний — з наявних дампів
//  однозначно не визначити (жоден із 49 не має цю суму зіпсованою, тобто
//  негативного прикладу немає). Тому коли сума не сходиться, правильний ремонт
//  — записати модельну частину з еталона, а не підганяти випадковий байт.
#define IMPRES_PROFILE_BEGIN  0x021
#define IMPRES_PROFILE_END    0x041   // не включно
#define IMPRES_PROFILE_SUM    0x00

// ---- запис COPYRIGHT -------------------------------------------------------
//  Запис довжини 0x20 за адресою 0x0E0 із рядком «COPYRIGHT20xxMOTOROLASOLUTIONS».
//  Має звичайну суму запису Σ≡0x5A, але ремонт цілісності його НЕ бачив: він
//  ішов ланцюгом лише від 0x120.
//
//  ⚠️ Наявність цього запису ЗАЛЕЖИТЬ ВІД МОДЕЛІ, і його відсутність — НЕ
//  дефект. У dumps/: він є в усіх 4409B / 4488A / 4493A / 4809A і його немає
//  в ЖОДНОГО 4409A та APLI4810C — при тому, що рація такі пакети приймає
//  написом «акумулятор impres (tm)». Тому перевіряємо суму лише тоді, коли
//  запис реально присутній.
#define IMPRES_COPYRIGHT_LEN  0x20

// ---- стан хвоста -----------------------------------------------------------
enum {
    IMPRES_TAIL_BLANK  = 0,  // ⛔ стертий у 0xFF — СКЕЛЕТ ЗНИЩЕНО, ЗП не зможе навчити
    IMPRES_TAIL_VALID  = 1,  // цілий ланцюг із навченими значеннями
    IMPRES_TAIL_BROKEN = 2,  // ланцюг б'ється
    IMPRES_TAIL_FRESH  = 3,  // ✅ скелет цілий, навчені значення обнулені — ЦІЛЬ ремонту
};

// ---------------------------------------------------------------- заголовок
inline bool impresHeaderOk(const uint8_t *d33) {
    int s = 0;
    for (int i = 0; i < IMPRES_HDR_END; i++) s += d33[i];
    return (s & 0xFF) == IMPRES_HDR_SUM;
}
inline void impresFixHeader(uint8_t *d33) {
    int s = 0;
    for (int i = 0; i < IMPRES_HDR_END - 1; i++) s += d33[i];
    d33[IMPRES_HDR_END - 1] = (uint8_t)((IMPRES_HDR_SUM - s) & 0xFF);
}

// Друга 32-байтна сума — блок профілю моделі (див. коментар вище).
inline bool impresProfileOk(const uint8_t *d33) {
    int s = 0;
    for (int i = IMPRES_PROFILE_BEGIN; i < IMPRES_PROFILE_END; i++) s += d33[i];
    return (s & 0xFF) == IMPRES_PROFILE_SUM;
}

// ---------------------------------------------------------------- записи
// Чи є за зсувом off коректний запис [len][...][Σ≡0x5A].
inline bool impresRecordOk(const uint8_t *d33, int off) {
    if (off < 0 || off >= IMPRES_33_SIZE) return false;
    int len = d33[off];
    if (len < 2 || off + len > IMPRES_33_SIZE) return false;
    int s = 0;
    for (int k = 0; k < len; k++) s += d33[off + k];
    return (s & 0xFF) == IMPRES_REC_SUM;
}
// Перерахувати контрольну суму запису довжини len за зсувом off.
inline void impresFixRecord(uint8_t *d33, int off, int len) {
    if (off < 0 || len < 2 || off + len > IMPRES_33_SIZE) return;
    int s = 0;
    for (int k = 0; k < len - 1; k++) s += d33[off + k];
    d33[off + len - 1] = (uint8_t)((IMPRES_REC_SUM - s) & 0xFF);
}

// ---------------------------------------------------------------- COPYRIGHT
// Чи присутній запис COPYRIGHT (незалежно від того, чи сходиться його сума).
//
// Пізнаємо за довжиною 0x20 ПЛЮС «тілом із друкованого тексту»: сама лише
// довжина не годиться (випадковий байт 0x20 на сміттєвому чипі виглядав би
// записом, і «ремонт» дописав би йому суму, зафіксувавши сміття). Але й шукати
// дослівно рядок «COPYRIGHT» не можна: пошкоджений байт саме в цьому слові
// зробив би запис невидимим — тобто рівно в тому випадку, заради якого
// перевірка й потрібна, вона б мовчала. Тому рахуємо частку друкованих
// символів: одна-дві побиті літери її не змінюють, а стертий (0xFF) чи
// занулений блок не проходить.
#define IMPRES_COPYRIGHT_MIN_ASCII 24     // із 30 байт тіла
inline bool impresHasCopyright(const uint8_t *d33) {
    if (d33[IMPRES_COPYRIGHT] != IMPRES_COPYRIGHT_LEN) return false;
    int printable = 0;
    for (int i = 1; i < IMPRES_COPYRIGHT_LEN - 1; i++) {   // тіло без довжини й суми
        uint8_t c = d33[IMPRES_COPYRIGHT + i];
        if (c >= 0x20 && c <= 0x5F) printable++;           // великі літери, цифри, пробіл
    }
    return printable >= IMPRES_COPYRIGHT_MIN_ASCII;
}
// Чи в порядку запис COPYRIGHT. Його відсутність — теж порядок: моделі 4409A
// й APLI4810C штатно його не мають, і рація такі пакети приймає.
inline bool impresCopyrightOk(const uint8_t *d33) {
    return !impresHasCopyright(d33) || impresRecordOk(d33, IMPRES_COPYRIGHT);
}
// Перерахувати суму запису COPYRIGHT. Повертає true, якщо щось виправлено.
// Питання «чи все гаразд» ставить предикат вище — двома копіями однієї умови
// цей проєкт уже горів.
inline bool impresFixCopyright(uint8_t *d33) {
    if (impresCopyrightOk(d33)) return false;
    impresFixRecord(d33, IMPRES_COPYRIGHT, IMPRES_COPYRIGHT_LEN);
    return true;
}

// Пройти ланцюг записів від start. Повертає к-сть знайдених записів;
// у *bad — к-сть записів із хибною сумою, у *end — зсув, на якому ланцюг
// завершився (-1, якщо наткнулися на неможливу довжину). Проміжки 0xFF
// пропускаються.
//
// У справному дампі ланцюг «упакований» до кінця чипа, тобто *end == 512.
// Рівно ОДИН запис у хвості (3 байти виду [0x03][прапорець][прапорець]) суми
// НЕ має: ЗП дописує ці два байти на місці, не перераховуючи нічого. Тому
// критерій цілісності хвоста — «дійшли рівно до 512 і не більше однієї
// розбіжності», а не «жодної розбіжності».
inline int impresWalk(const uint8_t *d33, int start, int *bad, int *end) {
    int n = 0, b = 0, i = start;
    while (i < IMPRES_33_SIZE) {
        if (d33[i] == 0xFF) { i++; continue; }
        int len = d33[i];
        if (len < 2 || i + len > IMPRES_33_SIZE) { if (end) *end = -1; if (bad) *bad = b; return n; }
        if (!impresRecordOk(d33, i)) b++;
        n++; i += len;
    }
    if (bad) *bad = b;
    if (end) *end = i;
    return n;
}

// ---------------------------------------------------------------- модель
// Запис моделі — це запис довжини 0x0B, чиї 9 байт даних — [A-Z0-9] (з
// доповненням пробілами) і сума якого ≡ 0x5A. Спочатку дивимось на штатне
// місце 0x148, потім скануємо чип. Перевірка суми прибирає хибні спрацювання
// «0x0B + літера» на стертих/сміттєвих чипах, через які модель писалася не туди.
inline bool impresModelAt(const uint8_t *d33, int off) {
    if (!impresRecordOk(d33, off) || d33[off] != IMPRES_MODEL_LEN) return false;
    bool digit = false, letter = false;
    for (int k = 0; k < IMPRES_MODEL_CHARS; k++) {
        uint8_t c = d33[off + 1 + k];
        if (c >= '0' && c <= '9') digit = true;
        else if (c >= 'A' && c <= 'Z') letter = true;
        else if (c != ' ') return false;
    }
    return digit && letter;
}
inline int impresFindModel(const uint8_t *d33) {
    if (impresModelAt(d33, IMPRES_MODEL_REC)) return IMPRES_MODEL_REC;
    for (int i = 0x20; i + IMPRES_MODEL_LEN <= IMPRES_33_SIZE; i++)
        if (impresModelAt(d33, i)) return i;
    return -1;
}
inline bool impresModelName(const uint8_t *d33, char *out, size_t n) {
    int off = impresFindModel(d33);
    if (off < 0 || n < 2) { if (n) out[0] = '\0'; return false; }
    size_t len = 0;
    for (int k = 0; k < IMPRES_MODEL_CHARS && len + 1 < n; k++) {
        uint8_t c = d33[off + 1 + k];
        if (c == ' ') break;
        out[len++] = (char)c;
    }
    out[len] = '\0';
    return len > 0;
}

// ---------------------------------------------------------------- хвіст
// Перевірено на всіх 49 дампах з dumps/: у ВСІХ 30 каталогізованих АКБ (і
// робочих, і «невідомих») хвіст = IMPRES_TAIL_VALID, а IMPRES_TAIL_BLANK /
// IMPRES_TAIL_BROKEN трапляються рівно там, де власник зафіксував, що рація й
// ЗП АКБ ПРИЙНЯЛИ (13-dozaryadka, 11-chastkove, 09-4409a-z-proshyvkoyu-4809a).
inline int impresTailState(const uint8_t *d33) {
    bool blank = true;
    for (int i = IMPRES_LEARNED_BEGIN; i < IMPRES_LEARNED_END; i++)
        if (d33[i] != 0xFF && d33[i] != 0x00) { blank = false; break; }
    if (blank) return IMPRES_TAIL_BLANK;
    int bad = 0, end = 0;
    int n = impresWalk(d33, IMPRES_LEARNED_BEGIN, &bad, &end);
    if (!(end == IMPRES_33_SIZE && n >= 3 && bad <= 1)) return IMPRES_TAIL_BROKEN;
    // «Чистий» хвіст: скелет цілий, але історія розряду (перший запис хвоста,
    // довжина 0x16) обнулена. Серед усіх 49 реальних дампів немає жодного АКБ із
    // нульовим цим записом, тож ознака однозначна.
    if (d33[IMPRES_LEARNED_BEGIN] == 0x16) {
        bool zero = true;
        for (int k = 1; k < 0x15; k++)
            if (d33[IMPRES_LEARNED_BEGIN + k]) { zero = false; break; }
        if (zero) return IMPRES_TAIL_FRESH;
    }
    return IMPRES_TAIL_VALID;
}
// ⚠️ СТЕРТИ хвіст у 0xFF — РУЧНИЙ/аварійний режим, для ремонту НЕ придатний.
// Знищує скелет записів, після чого ЗП не може записати навчену калібровку:
// рація АКБ приймає, але калібрування щоразу падає в помилку. Лишено лише для
// експериментів і аналізу. Штатний шлях — impresResetTail().
inline int impresEraseTail(uint8_t *d33) {
    int n = 0;
    for (int i = IMPRES_LEARNED_BEGIN; i < IMPRES_LEARNED_END; i++)
        if (d33[i] != 0xFF) { d33[i] = 0xFF; n++; }
    return n;
}

// ✅ ШТАТНИЙ РЕМОНТ: записати ЧИСТИЙ хвіст — скелет записів і сталі моделі на
// місці, навчені значення обнулені, суми правильні. freshTail — 118 байт
// (0x18A..0x1FF) із templates.h; читається з PROGMEM викликом rd (на не-AVR
// достатньо звичайного розіменування). Повертає к-сть змінених байт, або -1,
// якщо для цієї моделі перевіреного шаблону немає (тоді краще нічого не робити,
// ніж псувати пакет здогадкою).
inline int impresResetTailFrom(uint8_t *d33, const uint8_t *freshTail118) {
    if (!freshTail118) return -1;
    int n = 0;
    for (int k = 0; k < IMPRES_LEARNED_END - IMPRES_LEARNED_BEGIN; k++) {
        uint8_t v = freshTail118[k];
        if (d33[IMPRES_LEARNED_BEGIN + k] != v) { d33[IMPRES_LEARNED_BEGIN + k] = v; n++; }
    }
    return n;
}
// Стерти навчені записи ЄМНОСТІ (0x153..0x189) — глибша чистка, коли ЗП і після
// стирання хвоста тримає стару ємність. Модель (0x148..0x152) НЕ чіпаємо.
inline int impresEraseLearnedCapacity(uint8_t *d33) {
    int n = 0;
    for (int i = IMPRES_MODEL_REC + IMPRES_MODEL_LEN; i < IMPRES_LEARNED_BEGIN; i++)
        if (d33[i] != 0xFF) { d33[i] = 0xFF; n++; }
    return n;
}
// Стерти кільцевий журнал використання (історія сеансів). Ідентичність,
// copyright, заводську таблицю й модель не чіпає.
inline int impresEraseUsageLog(uint8_t *d33) {
    int n = 0;
    for (int i = IMPRES_LOG_BEGIN; i < IMPRES_COPYRIGHT; i++)
        if (d33[i] != 0xFF) { d33[i] = 0xFF; n++; }
    for (int i = IMPRES_LOG2_BEGIN; i < 0x120; i++)
        if (d33[i] != 0xFF) { d33[i] = 0xFF; n++; }
    return n;
}

// ---------------------------------------------------------------- DS2438
#define IMPRES_38_ETM_AT     0x08   // наробіток, 4 байти LE, секунди
// ⚑ ДВІ МІТКИ ПОДІЙ — В ОДИНИЦЯХ НАРОБІТКУ. Сторінка 2 монітора (0x10..0x17)
//  містить два 32-бітні числа, і це не дані користувача: на 51 дампі корпусу з
//  ненульовим ETM обидва числа лежать НЕ ВИЩЕ за ETM, а перше — у межах секунд
//  від нього. Тобто це «коли востаннє щось сталося», відлічене тим самим
//  лічильником наробітку.
//
//  ⚑ І САМЕ ЧЕРЕЗ НИХ ОБНУЛЕНИЙ НАРОБІТОК ПОВЕРТАВСЯ. Ми роками зануляли ETM,
//  не чіпаючи мітки, — і лишали монітор у неможливому стані «подія сталася в
//  майбутньому». Зарядна станція такий стан лікує очевидним чином: підтягує
//  наробіток до мітки. Доказ лежить у самому корпусі:
//
//      dumps/13-dozaryadka-na-stantsii/01_2438: ETM 234 c, мітка2 79 773 064
//      те саме після станції        /02_2438: ETM 79 773 372  — тобто мітка + 5 хв
//
//  Власник бачив це як «виставляю дату, ставлю в зарядку — і вона прописує
//  наробіток 17 років». Числа різні, механізм той самий.
#define IMPRES_38_STAMP1_AT  0x10   // остання подія, в одиницях ETM
#define IMPRES_38_STAMP2_AT  0x14   // попередня

// ⚑ І ТРЕТЯ МІТКА — ТА САМА ПОДІЯ, АЛЕ В ДОБАХ. Два байти за 0x32. Знайдена
//  так само, як і дві перші, — перебором по корпусу: на 62 дампах із
//  ненульовим ETM це число дорівнює МІТЦІ2, поділеній на 86400, у 46 випадках
//  точно, у 51 — з різницею не більше доби, медіана різниці нуль. Сусідні
//  0x34..0x37 і 0x3A..0x3B такої відповідності НЕ дають жодній величині
//  (медіана різниці — тисячі), тож їх не чіпаємо: писати в поле, призначення
//  якого не встановлене, — це той самий ризик, від якого ми лікуємо пакет.
//
//  ⚑ САМЕ ЧЕРЕЗ НЕЇ НАРОБІТОК ПОВЕРТАВСЯ ПІСЛЯ ПОВНОГО СКИДАННЯ. Ми зануляли
//  ETM і обидві 32-бітні мітки — і лишали цю. Доказ у корпусі, і він
//  однозначний:
//
//      dumps/19-stantsiya-dobudova/01_2438: ETM 0, мітка1 0, мітка2 0, CCA 0
//                                           — і 0x32 = 4015 діб
//
//  Тобто скидання зроблене бездоганно за всім, що ми знали, а пам'ять про
//  наробіток лишилась. Власник побачив це так: «при чистому DS2433 обнулив
//  лічильник наробітку монітора, вставив у зарядку — стало 4545».
#define IMPRES_38_STAMPD_AT  0x32   // та сама подія, у ДОБАХ (2 байти LE)

inline uint32_t impres38U32(const uint8_t *d38, int at) {
    return (uint32_t)d38[at] | ((uint32_t)d38[at + 1] << 8) |
           ((uint32_t)d38[at + 2] << 16) | ((uint32_t)d38[at + 3] << 24);
}
inline void impres38PutU32(uint8_t *d38, int at, uint32_t v) {
    d38[at]     = (uint8_t)(v & 0xFF);
    d38[at + 1] = (uint8_t)((v >> 8) & 0xFF);
    d38[at + 2] = (uint8_t)((v >> 16) & 0xFF);
    d38[at + 3] = (uint8_t)((v >> 24) & 0xFF);
}
inline uint32_t impresEtm(const uint8_t *d38) {          // секунди напрацювання
    return impres38U32(d38, IMPRES_38_ETM_AT);
}

// ЄДИНИЙ спосіб записати наробіток. Разом із ним підтягуються мітки подій:
// лишити мітку більшою за наробіток означає створити той самий неможливий
// стан, який станція «лікує» поверненням старого числа.
inline void impresSetEtm(uint8_t *d38, uint32_t sec) {
    impres38PutU32(d38, IMPRES_38_ETM_AT, sec);
    if (impres38U32(d38, IMPRES_38_STAMP1_AT) > sec) impres38PutU32(d38, IMPRES_38_STAMP1_AT, sec);
    if (impres38U32(d38, IMPRES_38_STAMP2_AT) > sec) impres38PutU32(d38, IMPRES_38_STAMP2_AT, sec);
    // Третя мітка міряється в ДОБАХ — тож і порівнюємо в добах. Лишити її
    // більшою за наробіток означає створити той самий неможливий стан
    // «подія в майбутньому», який станція лікує поверненням старого числа.
    uint32_t days = sec / 86400UL;
    uint16_t had  = (uint16_t)d38[IMPRES_38_STAMPD_AT] |
                    ((uint16_t)d38[IMPRES_38_STAMPD_AT + 1] << 8);
    if (had > days) {
        uint16_t v = (days > 0xFFFFUL) ? 0xFFFF : (uint16_t)days;
        d38[IMPRES_38_STAMPD_AT]     = (uint8_t)(v & 0xFF);
        d38[IMPRES_38_STAMPD_AT + 1] = (uint8_t)(v >> 8);
    }
}

// Прочитати третю мітку (доби) — читачам і тестам, щоб не рахувати зсув руками.
inline uint16_t impresStampDays(const uint8_t *d38) {
    return (uint16_t)d38[IMPRES_38_STAMPD_AT] |
           ((uint16_t)d38[IMPRES_38_STAMPD_AT + 1] << 8);
}
inline uint16_t impresCca(const uint8_t *d38) { return (uint16_t)d38[60] | ((uint16_t)d38[61] << 8); }
inline uint16_t impresDca(const uint8_t *d38) { return (uint16_t)d38[62] | ((uint16_t)d38[63] << 8); }
inline uint16_t impresVoltageMv(const uint8_t *d38) {
    return (uint16_t)(((uint16_t)d38[3] | ((uint16_t)d38[4] << 8)) * 10);
}
// ── ДЗЕРКАЛО ІДЕНТИЧНОСТІ: ОДНІ Й ТІ САМІ 26 БАЙТІВ У ДВОХ ЧИПАХ ──────────
//  DS2433[0x01..0x1A] і DS2438[0x18..0x31] несуть ОДНЕ І ТЕ САМЕ. Це не
//  надлишковість «про всяк випадок»: саме завдяки їй пакет зі стертим DS2433
//  ще можна впізнати, а зарядна станція WPLN4226A вміє відновити заголовок,
//  переписавши ці байти назад із монітора.
//
//  ⚑ ЗСУВИ — ОДНИМ ІМЕНЕМ, А НЕ ЧИСЛАМИ В ЦИКЛАХ. До цього «1 +» і «24 +»
//  стояли літералами щонайменше в п'яти місцях (тут, у sync, у двох клієнтських
//  обробниках і в режимі копії). Такі числа не помічають при правці й
//  розходяться поодинці.
#define IMPRES_MIRROR_D33_AT  0x01   // де дзеркало лежить у DS2433
#define IMPRES_MIRROR_D38_AT  0x18   // …і де воно ж у DS2438
#define IMPRES_MIRROR_LEN     26

inline bool impresMirrorOk(const uint8_t *d33, const uint8_t *d38) {
    for (int i = 0; i < IMPRES_MIRROR_LEN; i++)
        if (d33[IMPRES_MIRROR_D33_AT + i] != d38[IMPRES_MIRROR_D38_AT + i]) return false;
    return true;
}
// Чи придатне дзеркало як ДЖЕРЕЛО (не суцільні 0x00/0xFF).
inline bool impresMirrorUsable(const uint8_t *d38) {
    bool z = true, f = true;
    for (int i = 0; i < IMPRES_MIRROR_LEN; i++) {
        uint8_t b = d38[IMPRES_MIRROR_D38_AT + i];
        if (b) z = false;
        if (b != 0xFF) f = false;
    }
    return !z && !f;
}

// ── «СТАНЦІЯ ПОЧАЛА ДОБУДОВУ, АЛЕ НЕ ЗАКІНЧИЛА» ───────────────────────────
//  Одномісний зарядний WPLN4226A, побачивши стертий DS2433, сам вписує туди
//  дзеркало заголовка з DS2438 (26 байт), але контрольну суму не виправляє й
//  на цьому спиняється: профілю, запису моделі й блоків BMS не з'являється.
//
//  ⚑ ТРИ УМОВИ, І КОЖНА ПОТРІБНА.
//   • сума заголовка хибна — інакше нема чого добудовувати;
//   • дзеркало вже на місці й сходиться — це і є слід станції;
//   • РЕШТА ЧИПА ЩЕ ПОРОЖНЯ. Ось цієї умови бракувало, і саме вона несе всю
//     вагу: у СПРАВНОГО пакета дзеркало теж сходиться (на те воно й
//     дзеркало), тож пакет, який просто втратив байт суми, отримував діагноз
//     «станція почала добудову» і пораду добудувати давно побудоване.
//     Спіймано на 20-vymahaie-vidnovlennya/03 — 269 непорожніх байтів після
//     0x020 проти рівно 0 у справжньому випадку (19-stantsiya-dobudova).
//
//  ⚑ ЖИВЕ ТУТ, А НЕ В recovery.h, НАВМИСНО. recovery.h на хості не
//  збирається, тож тест тримав ДОСЛІВНУ КОПІЮ цього правила — і копія
//  пережила виправлення оригіналу, лишившись зеленою. Тепер правило одне.
inline bool impresChargerPartial(const uint8_t *d33, const uint8_t *d38, bool has38) {
    if (!d33 || !has38 || !d38) return false;
    bool blank = true;
    for (int i = 0; i < IMPRES_HDR_END; i++)
        if (d33[i] != 0xFF) { blank = false; break; }
    if (blank || impresHeaderOk(d33)) return false;
    for (int i = IMPRES_HDR_END; i < IMPRES_33_SIZE; i++)
        if (d33[i] != 0xFF) return false;          // чіп уже побудований
    return impresMirrorUsable(d38) && impresMirrorOk(d33, d38);
}
inline void impresSyncMirror(uint8_t *d33, const uint8_t *d38) {
    for (int i = 0; i < IMPRES_MIRROR_LEN; i++)
        d33[IMPRES_MIRROR_D33_AT + i] = d38[IMPRES_MIRROR_D38_AT + i];
    impresFixHeader(d33);
}

// Привести монітор до стану «новий пакет», НЕ стираючи його в 0xFF.
//
// ⚠️ Раніше «підготовка до калібрування» заливала DS2438 суцільним 0xFF. Це
// ламало сам монітор: у байт статусу/конфігу 0x00 потрапляло 0xFF (замість
// 0x0F — виставлені зарезервовані біти), у поріг 0x07 — 0xFF замість 0x40, і
// затиралися апаратний OFFSET АЦП струму (0x0D..0x0E) та ДЗЕРКАЛО (0x18..0x31).
// Симптом — ЗП бачить АКБ, світить зеленим і не заряджає. Тепер обнуляємо лише
// лічильники, зберігаючи конфіг, апаратне калібрування й дзеркало.
//
// ica — початковий паливомір (0..255). d33 може бути nullptr (тоді дзеркало
// не оновлюємо).
inline void impresResetMonitor(uint8_t *d38, const uint8_t *d33, uint8_t ica) {
    d38[0x00] = 0x0F;                       // IAD+CA+EE+AD, зарезервовані біти = 0
    d38[0x07] = 0x40;                       // поріг
    // ⚑ Разом із наробітком обнуляються ВСІ ТРИ МІТКИ ПОДІЙ (див. impresSetEtm):
    //  дві 32-бітні в секундах і третя, у добах, за 0x32. Доти вони лишались
    //  від старого життя пакета, і станція відновлювала з них наробіток — саме
    //  це видно в dumps/13 (у нас 234 c, після станції 923 доби) і, вже для
    //  третьої мітки, в dumps/19: ETM 0, обидві 32-бітні мітки 0, CCA 0 — і
    //  4015 діб у 0x32, які пережили бездоганне скидання.
    impresSetEtm(d38, 0);
    d38[0x0C] = ica;                        // паливомір
    d38[0x0F] = 0xFC;                       // стале у всіх справних АКБ
    d38[0x3C] = d38[0x3D] = 0x00;           // CCA -> 0
    d38[0x3E] = d38[0x3F] = 0x00;           // DCA -> 0
    if (d33) for (int i = 0; i < 26; i++) d38[24 + i] = d33[1 + i];
}

// ---------------------------------------------------------------- ємність
// Паспортна ємність за моделлю. У прошивці її НЕМАЄ у придатному для читання
// вигляді: PMNN4409A і PMNN4409B мають однакові «ємнісні» поля заголовка, а
// PMNN4488A і PMNN4493A — взагалі побайтово однаковий заголовок і різняться
// лише рядком назви. Тому — таблиця, яку можна правити під свої пакети.
struct ImpresRated { const char *model; int mah; };
//  ⚑ Значення звірені з ДВОМА незалежними джерелами й виправлені:
//    1) байт 0x008 самого чипа (див. impresRatedFromDump нижче) — те, що
//       пакет носить із собою;
//    2) таблиця batteryKITList із rick51231/node-dmr-lib (dev/BMS) — витягнута
//       з фірмового ПЗ «IMPRES Battery Fleet Management».
//  Три значення були хибні й псували перерахунок паливоміра в мА*год:
//    PMNN4409B  2250 -> 2150   (чип 0x56, KIT 2150)
//    PMNN4809A  2450 -> 2700   (чип 0x6C, KIT 2700)
//    APLI4810C  2450 -> 3100   (чип 0x7C, KIT PMNN4810 = 3100) — похибка 27 %
static const ImpresRated IMPRES_RATED[] = {
    { "PMNN4409A", 2150 },
    { "PMNN4409B", 2150 },
    { "PT4409A",   2150 },   // копія 4409A
    { "PMNN4488A", 3000 },   // чип каже 2950; KIT — 3000 (кругле паспортне)
    { "PMNN4493A", 3000 },   // те саме
    { "PMNN4809A", 2700 },
    { "APLI4810C", 3100 },
    { "APLI4811C", 3100 },   // R7; чип теж каже 3100
    // Далі — з KIT-таблиці Motorola, шаблонів у нас поки немає, але ємність
    // знадобиться, щойно такий пакет прочитають.
    { "PMNN4403A", 2150 },
    { "PMNN4407A", 1500 },
    { "PMNN4417A", 1500 },
    { "PMNN4418A", 2150 },
    { "PMNN4448A", 2800 },
    { "PMNN4491A", 2100 },
    { "PMNN4499A", 3000 },
    { "PMNN4502A", 3000 },
    { "PMNN4525A", 1950 },
    { "PMNN4543A", 2450 },
    { "PMNN4544A", 2450 },
    { "PMNN4548A", 2450 },
    { "PMNN4807A", 2050 },
    { "PMNN4808A", 2300 },
    { "PMNN4810A", 3100 },
};
static const int IMPRES_RATED_N = (int)(sizeof(IMPRES_RATED) / sizeof(IMPRES_RATED[0]));
#ifndef IMPRES_RATED_DEFAULT
  #define IMPRES_RATED_DEFAULT 2500
#endif

inline int impresRatedMah(const char *model) {
    if (model && *model)
        for (int i = 0; i < IMPRES_RATED_N; i++)
            if (strcmp(IMPRES_RATED[i].model, model) == 0) return IMPRES_RATED[i].mah;
    return IMPRES_RATED_DEFAULT;
}

// ---- паспортна ємність ІЗ САМОГО ЧИПА ---------------------------------------
//  Байт 0x008 DS2433 = ємність / 25. Знайдено так: у протоколі BMS
//  (rick51231/node-dmr-lib, dev/BMS/README.md) розширений пакет несе
//  «Rated capacity mAh, Formula = value*25»; пошук байта з такою властивістю в
//  наших 49 дампах дав рівно один зсув, сталий усередині кожної моделі, — 0x008.
//
//  Звірка (чип*25 проти KIT-таблиці Motorola):
//    PMNN4409A/B  0x56 -> 2150 = 2150 ✔
//    PMNN4809A    0x6C -> 2700 = 2700 ✔
//    APLI4810C    0x7C -> 3100 = 3100 ✔ (а в нашій таблиці стояло 2450!)
//    PMNN4488A/93A 0x76 -> 2950, KIT 3000 — чип точніший за кругле паспортне.
//
//  Це надійніше за таблицю: працює й для моделей, яких у ній немає взагалі.
//  0 — якщо дампа немає або значення неправдоподібне.
#define IMPRES_RATED_BYTE     0x008
#define IMPRES_RATED_STEP     25
#define IMPRES_RATED_MIN_MAH  1000
#define IMPRES_RATED_MAX_MAH  6000
inline int impresRatedFromDump(const uint8_t *d33) {
    if (!d33) return 0;
    int mah = (int)d33[IMPRES_RATED_BYTE] * IMPRES_RATED_STEP;
    return (mah >= IMPRES_RATED_MIN_MAH && mah <= IMPRES_RATED_MAX_MAH) ? mah : 0;
}

// Паспортна ємність: спершу з чипа, потім із таблиці за моделлю.
inline int impresRatedMahFor(const uint8_t *d33, const char *model) {
    int m = impresRatedFromDump(d33);
    return m ? m : impresRatedMah(model);
}

// ── ЗАРЯД У ВІДСОТКАХ ЗА НАПРУГОЮ ────────────────────────────────────────
//  ⚑ ТУТ БУЛА ЛІНІЙКА, І ЦЕ БУЛА ПОМИЛКА. Відсоток рахувався прямою між
//  «порожньо» і «повно»:
//
//      p = (mv - 6350) * 100 / (8250 - 6350)
//
//  Для літію пряма не годиться: крива напруги спокою — полога сходинка з
//  довгим плато посередині. На 7.00 В лінійка казала 34 %, тоді як у пакета
//  лишалось близько 8 %. Помилка була найбільша саме там, де вона найдорожча.
//
//  Тепер обидві функції — тонкі обгортки над табличною кривою 2S (soc.h).
//  Власної арифметики тут більше немає навмисно: два джерела однієї шкали
//  розійшлись би, і половина поверхонь показувала б інше число.
inline int impresPercentFromMv(int mv) { return socPctFromMv(mv); }

// Обернена функція — потрібна для вибору ЦІЛІ заряду відсотком (керований
// заряд, charge.h): відсоток -> напруга. Та сама крива, просто в інший бік.
inline int impresMvFromPercent(int pct) { return socMvFromPct(pct); }
// ICA, що відповідає заданому відсотку. Шкала АПАРАТНА (див. блок нижче), тож
// 100 % — це не 255, а стільки одиниць, скільки важить повний пакет:
// ratedMah * Rsense / 0.4882. Без відомого шунта лишається стара шкала 0..255.
inline uint8_t impresIcaFromPercentRs(int pct, int ratedMah, float rsOhm);
inline uint8_t impresIcaFromPercent(int pct) {
    if (pct < 0) pct = 0;
    if (pct > 100) pct = 100;
    return (uint8_t)((pct * 255 + 50) / 100);
}

// ─────────────────────────── ПАЛИВОМІР ICA ────────────────────────────────
//  ICA — це АПАРАТНИЙ інтегратор DS2438: чіп сам віднімає від нього заряд, що
//  витік із пакета. Ціна одиниці за даташитом — 0.4882 мВ·год, тобто в мА·год
//  вона залежить від шунта: 0.4882 / Rsense.
//
//  ⚠️ ІСТОРІЯ ПОМИЛКИ (дві ітерації).
//   1. Спершу рахували ica * DS2438_MAH_PER_LSB із зашитим Rsense = 0.025 Ом.
//      Виходило 19.5 мА·год на одиницю і повна шкала 4978 мА·год — удвічі
//      більше за будь-який пакет, тож числа не збігалися зі станцією.
//   2. Тоді шкалу «випрямили» через паспортну ємність: 255 = повний пакет.
//      Це прибрало симптом, але зламало суть: чіп ПРОДОВЖУВАВ віднімати
//      апаратними одиницями. Через це наприкінці розряду ICA зупинявся не на
//      нулі, а десь на 50 — саме те «незрозуміле кінцеве значення», яке видно
//      в режимі розряду. Для PMNN4409A: повний пакет 2150 мА·год при шунті
//      0.0459 Ом — це 202 одиниці, а ми ставили на старті 255.
//
//  Причина обох помилок одна: шунт брали з константи, а він СВІЙ у кожного
//  пакета і лежить у DS2438[56..57] (impres_bms.h, розділ 4a.2 документа).
//  Тепер рахуємо як фірмове ПЗ Motorola — 1000*ICA/(2048*Rsense), — і шкала
//  збігається з апаратною, тож розряд доводить паливомір рівно до нуля.
//
//  rsOhm <= 0 — шунт невідомий; тоді падаємо на паспортну ємність (стара
//  поведінка), бо це все одно краще, ніж завідомо чужа константа.
#define IMPRES_ICA_MVH 0.48828125f

inline int impresIcaToMahRs(uint8_t ica, int ratedMah, float rsOhm) {
    if (rsOhm > 0.0f) return (int)(IMPRES_ICA_MVH * ica / rsOhm + 0.5f);
    return (int)(((long)ica * ratedMah) / 255);
}
inline uint8_t impresIcaFromMahRs(long mah, int ratedMah, float rsOhm) {
    if (mah < 0) mah = 0;
    long ica;
    if (rsOhm > 0.0f) ica = (long)(mah * rsOhm / IMPRES_ICA_MVH + 0.5f);
    else {
        if (ratedMah <= 0) ratedMah = IMPRES_RATED_DEFAULT;
        ica = (mah * 255 + ratedMah / 2) / ratedMah;
    }
    if (ica > 255) ica = 255;
    if (ica < 0)   ica = 0;
    return (uint8_t)ica;
}
// Відсоток → апаратні одиниці. Без шунта падає на паспортну шкалу.
inline uint8_t impresIcaFromPercentRs(int pct, int ratedMah, float rsOhm) {
    if (pct < 0) pct = 0;
    if (pct > 100) pct = 100;
    if (rsOhm <= 0.0f) return impresIcaFromPercent(pct);
    if (ratedMah <= 0) ratedMah = IMPRES_RATED_DEFAULT;
    return impresIcaFromMahRs((long)ratedMah * pct / 100, ratedMah, rsOhm);
}
// Відсоток заряду за паливоміром: залишок у мА·год від паспортної ємності.
// Раніше це було просто ica*100/255, що при апаратній шкалі неправильно.
inline int impresPercentFromIca(uint8_t ica, int ratedMah, float rsOhm) {
    if (ratedMah <= 0) ratedMah = IMPRES_RATED_DEFAULT;
    // Округлюємо, а не відкидаємо: запис 100 % дає цілу кількість апаратних
    // одиниць, а зворотний перерахунок губить частку — і повний пакет
    // показувався б як 99 %.
    long p = ((long)impresIcaToMahRs(ica, ratedMah, rsOhm) * 100 + ratedMah / 2) / ratedMah;
    if (p < 0)   p = 0;
    if (p > 100) p = 100;
    return (int)p;
}

// ---------------------------------------------------------------- формат
inline int impresFormatYear(const uint8_t *d33) {
    static const char c21[] = "COPYRIGHT2021", c14[] = "COPYRIGHT2014", mot[] = "MOTOROLA";
    for (int i = 0; i + 13 <= IMPRES_33_SIZE; i++) {
        if (memcmp(d33 + i, c21, 13) == 0) return 2021;
        if (memcmp(d33 + i, c14, 13) == 0) return 2014;
    }
    for (int i = 0; i + 8 <= IMPRES_33_SIZE; i++)
        if (memcmp(d33 + i, mot, 8) == 0) return 2017;
    return 0;
}

#endif // IMPRES_FORMAT_H
