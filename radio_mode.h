#ifndef RADIO_MODE_H
#define RADIO_MODE_H
// ===========================================================================
//  radio_mode.h — ЯКИМ РАДІО ПРИСТРІЙ РОЗМОВЛЯЄ З КЛІЄНТАМИ
// ===========================================================================
//  Радіо в ESP32 одне, а стеків два: Wi-Fi (точка доступу + веб) і класичний
//  Bluetooth (SPP, тобто COM-порт по ефіру). Разом вони працюють, але ділять
//  і ефір, і пам'ять — і саме пам'ять тут вирішальна: стек Bluedroid бере
//  близько 70 КБ ОДНИМ шматком. Тримати обидва піднятими означає жити на
//  залишках купи в приладі, який і без того ловив перезавантаження від
//  фрагментації (див. 3.11).
//
//  Тому режим один за раз: Wi-Fi АБО Bluetooth. Це не економія заради
//  економії — це умова, за якої обидва працюють передбачувано.
//
//  ⚑ ЧОМУ ЛОГІКА ЖИВЕ В ОКРЕМОМУ ФАЙЛІ. `web_server.h` і скетч на хості не
//  збираються (за ними весь Arduino-світ), а правила тут саме ті, які треба
//  перевіряти: «радіо рівно одне», «невідомий режим — це Wi-Fi», «збережений
//  Bluetooth на прошивці без Bluetooth не лишає прилад німим». Написані
//  всередині обробників, вони не покривались би жодним тестом — той самий
//  прийом, що з `charge.h` проти `web_server.h` і з `moto_models.py` проти
//  `moto_gui.py`.
// ===========================================================================

#include <stdint.h>
#include <stdio.h>
#include <string.h>

#include "settings.h"        // BT_ENABLED — чи вкомпільовано стек Bluetooth

enum { RADIO_WIFI = 0, RADIO_BT = 1, RADIO_COUNT = 2 };

// Чи є в ЦІЙ прошивці стек класичного Bluetooth. Це властивість ЗБІРКИ, а не
// налаштування: BT_ENABLED тягне за собою Bluedroid, а з ним — обов'язкову
// схему розділів «Huge APP». Зібрана без нього прошивка про Bluetooth не знає
// нічого, і чесна відповідь тут — «його немає», а не «він вимкнений».
inline bool radioBtCompiled() {
#ifdef BT_ENABLED
    return true;
#else
    return false;
#endif
}

inline const char *radioModeName(uint8_t m) {
    switch (m) {
        case RADIO_WIFI: return "Wi-Fi";
        case RADIO_BT:   return "Bluetooth";
        default:         return "?";
    }
}

// Короткий підпис для рядка меню, де місця на «Bluetooth» може не вистачити.
inline const char *radioModeShort(uint8_t m) {
    switch (m) {
        case RADIO_WIFI: return "Wi-Fi";
        case RADIO_BT:   return "BT";
        default:         return "?";
    }
}

// ── ГОЛОВНЕ ПРАВИЛО: РАДІО РІВНО ОДНЕ ─────────────────────────────────────
//  Дві функції, а не одна з запереченням, бо їх читають два різні місця
//  скетча (підйом точки доступу й підйом Bluetooth), і кожне мусить питати
//  ПРО СЕБЕ. Одна функція з `!` на другому виклику виглядала б так само, але
//  першою ж правкою («а давайте тут ще й веб при BT») тихо розійшлася б.
//  Що вони не можуть відповісти «так» обидві — доводить хостовий тест.
inline bool radioWantsWifi(uint8_t m) { return m != RADIO_BT; }
inline bool radioWantsBt(uint8_t m)   { return m == RADIO_BT; }

// Привести збережене/прийняте число до режиму, який ця прошивка справді може
// підняти.
//
//  ⚑ ЦЕ НЕ КОСМЕТИКА, А ЗАПОБІЖНИК ВІД НІМОГО ПРИЛАДУ. У файлі лежить число;
//  прошивку могли перезібрати без Bluetooth, файл міг побитись, число могло
//  прийти ззовні. У кожному з цих випадків «просто повірити» означає підняти
//  НЕ ТЕ радіо або жодного — і прилад мовчить в обох ефірах, а достукатись до
//  нього можна тільки кабелем. Wi-Fi тут правильний бік замовчування: точка
//  доступу є в будь-якій збірці.
//  ⚑ НАЯВНІСТЬ BLUETOOTH — ПАРАМЕТР, А НЕ #ifdef УСЕРЕДИНІ ПРАВИЛА. Збірка
//  буває рівно одна за раз, тож правило, написане через #ifdef, перевірялось
//  би теж лише в одному зі світів — а другий (той, де Bluetooth немає) саме й
//  вирішує, чи лишиться прилад німим. Тому ядро приймає доступність числом, а
//  тонка обгортка підставляє в нього справжню відповідь ЦІЄЇ збірки.
inline uint8_t radioModeSanitizeFor(uint8_t m, bool btAvail) {
    if (m >= RADIO_COUNT)          return RADIO_WIFI;
    if (m == RADIO_BT && !btAvail) return RADIO_WIFI;
    return m;
}
inline uint8_t radioModeSanitize(uint8_t m) {
    return radioModeSanitizeFor(m, radioBtCompiled());
}

// Наступний режим по колу. Недоступні пропускаються, тож на прошивці без
// Bluetooth пункт меню просто нічого не змінює — і це чесніше, ніж дати
// обрати режим, який не підніметься.
inline uint8_t radioModeNextFor(uint8_t m, bool btAvail) {
    for (int i = 1; i <= RADIO_COUNT; i++) {
        uint8_t c = (uint8_t)((m + i) % RADIO_COUNT);
        if (c == radioModeSanitizeFor(c, btAvail)) return c;
    }
    return RADIO_WIFI;
}
inline uint8_t radioModeNext(uint8_t m) {
    return radioModeNextFor(m, radioBtCompiled());
}

// Чи є взагалі з чого вибирати. Якщо режим один, пункт меню лишається видимим
// (щоб було видно, ЧОМУ Bluetooth недоступний), але нічого не перемикає.
inline bool radioSwitchable() { return radioBtCompiled(); }

// ── ПОТОЧНИЙ РЕЖИМ І ЙОГО ПЕРЕМИКАННЯ ─────────────────────────────────────
//  ⚑ СТАН ЖИВЕ ТУТ, А НЕ В web_server.h, І ЦЕ НЕ ПЕРЕСТАНОВКА ЗАРАДИ ПОРЯДКУ.
//  Читає його не тільки веб: назву пункту меню збирає operations.h, а малює
//  драйвер екрана — жоден із них про web_server.h не знає й знати не мусить
//  (на хості той не збирається взагалі). Тримати стан за файловою системою
//  означало б, що перемикач видно лише звідти, звідки до нього дотягнувся
//  веб-сервер. Той самий поділ, що в charge.h: правило й стан — тут, робота з
//  SPIFFS — там.
#define RADIO_MODE_DEFAULT RADIO_WIFI
static uint8_t g_radioMode   = RADIO_MODE_DEFAULT;
static bool    g_radioDirty  = false;   // просили зберегти
static bool    g_radioReboot = false;   // …і перезавантажитись

inline uint8_t radioMode() { return g_radioMode; }
inline bool radioConsumeSave()   { bool d = g_radioDirty;  g_radioDirty  = false; return d; }
inline bool radioConsumeReboot() { bool d = g_radioReboot; g_radioReboot = false; return d; }

// Застосувати прочитане з файла. Окремо від перемикання: тут НЕ виставляється
// ані прапорець запису, ані перезавантаження — ми щойно це прочитали, писати
// назад нічого, а рестарт при кожному ввімкненні був би вічним циклом.
inline void radioModeSet(uint8_t m) { g_radioMode = radioModeSanitize(m); }

// ── ПЕРЕМКНУТИ РЕЖИМ ЗВ'ЯЗКУ ──────────────────────────────────────────────
//  Повертає режим, який буде ПІСЛЯ перезавантаження.
//
//  ⚑ ЗБЕРЕГТИ Й ПЕРЕЗАВАНТАЖИТИСЬ, А НЕ ПЕРЕМКНУТИ НА ЛЬОТУ. Стек Bluedroid
//  бере ~70 КБ одним шматком; піднімати його на купі, по якій уже походили
//  веб-сервер, SPIFFS і драйвер екрана, — це той самий клас відмов, що
//  розбирався в 3.11, тільки цього разу він давав би «Bluetooth не запустився»
//  без жодної видимої причини. При старті купа ціла, і режим піднімається
//  однаково щоразу.
//
//  Ціни тут майже немає: перемикання й так рве поточного клієнта — Wi-Fi
//  гасне. Перезавантаження просто робить це чесно й до кінця.
//
//  ⚑ І НЕ ПРОСИТЬ РЕСТАРТУ ДАРМА. Коли перемикати нема на що (прошивка без
//  Bluetooth), режим лишається тим самим — а отже й перезавантажувати прилад
//  нема за чим. Рестарт, який нічого не змінює, читався б як несправність.
inline uint8_t radioCycleMode() {
    uint8_t next = radioModeNext(g_radioMode);
    if (next == g_radioMode) return g_radioMode;
    g_radioMode   = next;
    g_radioDirty  = true;
    g_radioReboot = true;
    return g_radioMode;
}

// ── ФАЙЛ НАЛАШТУВАНЬ ПРИСТРОЮ ─────────────────────────────────────────────
//  Один рядок «ключ=значення» у /device.cfg, читабельний очима. Формат став
//  v2: до «заряду немає» додався режим радіо.
//
//  ⚑ v1 ЧИТАЄТЬСЯ ДАЛІ, І ЦЕ НЕ ВВІЧЛИВІСТЬ. У приладі власника цей файл уже
//  лежить, і в ньому записано, що силової частини немає. Перестати його
//  розуміти означало б, що після оновлення прилад кілька секунд скаржиться на
//  блок живлення, якого в ньому не передбачено, — тобто оновлення виглядало б
//  як поломка.
//
//  Розбір і складання — тут, а не в web_server.h, і саме тому, що на хості
//  перевірити можна лише те, що звідти дістає тест.
#define DEVICE_CFG_PATH "/device.cfg"

//  ⚑ ЦІ ДВІ ФУНКЦІЇ НІЧОГО НЕ ВИРІШУЮТЬ ПРО ЗАЛІЗО. Вони лише складають і
//  розбирають РЯДОК. Спокуса «заразом і перевірити, чи можна такий режим
//  підняти» тут пряма — і це був би десятий випадок «одне поле, два питання»:
//  на питання «що можна підняти» вже відповідає radioModeSanitize(), і другий
//  відповідач розійшовся б із ним першою ж правкою. Розбір каже, ЩО ЗАПИСАНО;
//  чи можна це підняти — питає той, хто піднімає.
inline int radioCfgFormat(char *buf, size_t n, uint8_t mode, bool chgOff) {
    return snprintf(buf, n, "v2 chgoff=%d radio=%d\n", chgOff ? 1 : 0, (int)mode);
}

// Повертає false, якщо рядок не розібрався взагалі; тоді виходи не чіпаються.
// Рядок v1 розбирається як «режим Wi-Fi» — саме так поводився прилад доти.
inline bool radioCfgParse(const char *line, uint8_t *mode, bool *chgOff) {
    if (!line) return false;
    int off = 0, r = 0;
    if (sscanf(line, "v2 chgoff=%d radio=%d", &off, &r) == 2) {
        if (chgOff) *chgOff = (off != 0);
        if (mode)   *mode   = (uint8_t)r;
        return true;
    }
    if (sscanf(line, "v1 chgoff=%d", &off) == 1) {
        if (chgOff) *chgOff = (off != 0);
        if (mode)   *mode   = RADIO_WIFI;
        return true;
    }
    return false;
}

#endif // RADIO_MODE_H
