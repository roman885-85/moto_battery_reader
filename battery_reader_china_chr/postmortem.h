#pragma once
// ===========================================================================
//  postmortem.h — ЧОРНИЙ ЯЩИК: ЩО ПРИСТРІЙ РОБИВ ПЕРЕД ПЕРЕЗАВАНТАЖЕННЯМ
// ===========================================================================
//  Скарга «під час заряду/розряду пристрій періодично перезавантажується»
//  тягнеться довго, і кожна спроба її закрити була здогадкою: сторож,
//  пам'ять, живлення, ШІМ. Здогадки коштували часу тому, що ПІСЛЯ скидання від
//  події не лишалось нічого — крім причини скидання, яку треба ще й побачити в
//  USB-консолі, а прилад працює без комп'ютера.
//
//  Тут це виправляється по суті: раз на опитування пристрій записує кілька
//  чисел у RTC-пам'ять, яка ПЕРЕЖИВАЄ скидання (її не чіпає завантажувач,
//  якщо оголосити змінні з RTC_NOINIT_ATTR). Після перезавантаження ці числа
//  друкуються в журнал і віддаються клієнтам — тобто наступний випадок уже не
//  «періодично перезавантажується», а «впав на 47-й хвилині заряду, шпаруватість
//  1200, вільної купи 9 КБ, запас стека 700 байтів».
//
//  ⚑ ЩО САМЕ ПИШЕМО І ЧОМУ ЦЕ ТРИ РІЗНІ ПІДОЗРЮВАНІ:
//   • вільна купа й найбільший суцільний блок — фрагментація (класична
//     причина падінь після годин роботи: пам'яті «начебто вистачає», а
//     суцільного шматка під буфер Wi-Fi уже немає);
//   • запас стека задачі loop() — переповнення стека дає скидання, яке ззовні
//     не відрізнити від зависання;
//   • режим, час і шпаруватість — чи прив'язана подія до конкретного місця
//     профілю (наприклад, до переходу на дозаряд) чи трапляється будь-коли.
//
//  Ціна — 24 байти RTC-пам'яті й кілька присвоєнь раз на секунду.
// ===========================================================================

#include <stdint.h>

#define PM_MAGIC 0x4D42504DUL      // 'MPBM' — ознака, що в RTC саме наші дані

// Що робив пристрій.
#define PM_MODE_IDLE      0
#define PM_MODE_CHARGE    1
#define PM_MODE_DISCHARGE 2
#define PM_MODE_READ      3
#define PM_MODE_WRITE     4

inline const char *pmModeName(uint8_t m) {
    switch (m) {
        case PM_MODE_CHARGE:    return "ЗАРЯД";
        case PM_MODE_DISCHARGE: return "РОЗРЯД";
        case PM_MODE_READ:      return "ЧИТАННЯ";
        case PM_MODE_WRITE:     return "ЗАПИС";
        default:                return "спокій";
    }
}

// Чи є причина скидання НЕНОРМАЛЬНОЮ, тобто такою, про яку треба доповідати.
//  Подача живлення, кнопка RESET і навмисний ESP.restart() — штатні події, і
//  показувати про них «аварію» означало б привчити не звертати уваги на
//  повідомлення. Усе інше — паніка, сторож, просадка живлення — аварія.
//
//  Числа збігаються з esp_reset_reason_t; беремо їх як int, щоб заголовок
//  лишався чистим і збирався в хостовому тесті.
#define PM_RST_UNKNOWN   0
#define PM_RST_POWERON   1
#define PM_RST_EXT       2
#define PM_RST_SW        3
#define PM_RST_PANIC     4
#define PM_RST_INT_WDT   5
#define PM_RST_TASK_WDT  6
#define PM_RST_WDT       7
#define PM_RST_DEEPSLEEP 8
#define PM_RST_BROWNOUT  9
#define PM_RST_SDIO      10

inline bool pmIsAbnormal(int reason) {
    switch (reason) {
        case PM_RST_POWERON:
        case PM_RST_EXT:
        case PM_RST_SW:
        case PM_RST_DEEPSLEEP:
            return false;
        default:
            return true;      // невідома причина — теж аварія, а не «нормально»
    }
}

// ── ЕТАП ВСЕРЕДИНІ ОПИТУВАННЯ ─────────────────────────────────────────────
//  Причина скидання й обставини звужують пошук до «паніка під час заряду на
//  10-му опитуванні» — але не кажуть, У ЯКОМУ САМЕ місці. Блок Guru Meditation
//  із backtrace друкується в UART перед перезавантаженням і його легко не
//  зловити; крім того, прилад працює без комп'ютера.
//
//  Тому опитування розмічене на етапи, і номер поточного лежить у тій самій
//  RTC-пам'яті. Після скидання видно не «десь у заряді», а «на читанні
//  DS2438» — тобто одразу той десяток рядків, де шукати.
//
//  Коштує це один запис у пам'ять на етап.
#define PM_STEP_NONE      0
#define PM_STEP_ISENSE    1   // серія відліків струму на шунті
#define PM_STEP_VSENSE    2   // напруга на клемі при закритому ключі
#define PM_STEP_PSU       3   // напруга живлення +14 В
#define PM_STEP_DS2438    4   // читання монітора по 1-Wire (найдовше й найризикованіше)
#define PM_STEP_REGULATOR 5   // профіль струму й перерахунок шпаруватості
#define PM_STEP_REPORT    6   // журнал, екран, віддача стану
#define PM_STEP_LOAD      7   // керування ключем розряду

inline const char *pmStepName(uint8_t st) {
    switch (st) {
        case PM_STEP_ISENSE:    return "вимір струму";
        case PM_STEP_VSENSE:    return "вимір напруги на клемі";
        case PM_STEP_PSU:       return "вимір живлення +14 В";
        case PM_STEP_DS2438:    return "читання DS2438 по 1-Wire";
        case PM_STEP_REGULATOR: return "регулятор шпаруватості";
        case PM_STEP_REPORT:    return "журнал і екран";
        case PM_STEP_LOAD:      return "керування ключем розряду";
        default:                return "поза опитуванням";
    }
}

// Слід останнього опитування. Рівно те, що треба знати, і нічого зайвого:
// кожне поле — окремий підозрюваний.
struct PmTrace {
    uint32_t magic;
    uint32_t ms;          // скільки пропрацював до останнього запису
    uint32_t freeHeap;    // вільна купа, байтів
    uint32_t maxBlock;    // найбільший суцільний блок — ознака фрагментації
    uint32_t stackLeft;   // запас стека задачі loop(), байтів
    uint16_t polls;       // яке за ліком опитування
    uint16_t duty;        // шпаруватість ключа
    int16_t  ma;
    uint16_t mv;
    uint8_t  mode;        // PM_MODE_*
    uint8_t  step;        // PM_STEP_* — де саме всередині опитування ми були
};

// Чи можна вірити тому, що лежить у RTC. Після подачі живлення там сміття, і
// показати його як «останній стан» було б гірше, ніж не показати нічого.
inline bool pmTraceValid(const PmTrace &t, int resetReason) {
    if (t.magic != PM_MAGIC) return false;
    if (resetReason == PM_RST_POWERON) return false;   // холодний старт — RTC не зберігся
    return true;
}
